## CMakeLists.txt
```
# Copyright (c) 2026 zlrs contributors
# SPDX-License-Identifier: Apache-2.0

cmake_minimum_required(VERSION 3.20.0)
# An including test application initializes its own Zephyr project first.
if("${CMAKE_CURRENT_SOURCE_DIR}" STREQUAL "${CMAKE_CURRENT_LIST_DIR}")
  find_package(Zephyr REQUIRED HINTS $ENV{ZEPHYR_BASE})
  project(app LANGUAGES C)
endif()

set(zlrs_app_dir "${CMAKE_CURRENT_LIST_DIR}")
include("${zlrs_app_dir}/src/CMakeLists.txt")

target_sources(app PRIVATE
  ${zlrs_app_dir}/src/mgmt.c
  ${zlrs_app_dir}/src/serial.c
  ${zlrs_app_dir}/src/power.c
  ${zlrs_app_dir}/src/band.c
  ${zlrs_app_dir}/src/main.c
  ${zlrs_app_dir}/src/rf.c
  ${zlrs_app_dir}/src/persist.c
  ${zlrs_app_dir}/src/lifecycle.c
  ${zlrs_app_dir}/src/platform/sha256.c
  ${zlrs_app_dir}/src/platform/slot_timer.c
  ${zlrs_app_dir}/src/platform/watchdog.c
  ${zlrs_app_dir}/src/platform/lr2021.c
  ${zlrs_app_dir}/src/log.c
  ${zlrs_app_dir}/src/ui.c
)

target_sources_ifdef(CONFIG_ZLRS_APP_DEBUG_TRACE app PRIVATE
  ${zlrs_app_dir}/src/trace.c
)

if(CONFIG_ZLRS_APP_DEBUG_TRACE)
  # Zephyr 4.5's GPIO function hooks do not consult CONFIG_TRACING_GPIO.
  # Use the tracing macros' API-type masks without replacing the CTF hooks.
  if(NOT CONFIG_TRACING_GPIO)
    zephyr_compile_definitions(
      sys_port_trace_gpio_is_disabled=1
      sys_port_trace_gpio_pin_is_disabled=1
      sys_port_trace_gpio_port_is_disabled=1
    )
  endif()
  # SPI CS calls k_busy_wait(0) twice per transaction. Mask this source only;
  # the rest of the kernel retains k_thread scheduling and lifecycle events.
  set_property(SOURCE ${ZEPHYR_BASE}/kernel/busy_wait.c
    DIRECTORY ${ZEPHYR_BASE}/kernel APPEND PROPERTY COMPILE_DEFINITIONS
    sys_port_trace_k_thread_is_disabled=1
  )
endif()

# App-internal headers use their paths on disk, such as "platform/lr2021.h" and "serial.h"
# (the layers are described in doc/05-architecture.md).
target_include_directories(app PRIVATE
  "${zlrs_app_dir}/src"
)

if(CONFIG_CODE_DATA_RELOCATION)
  set(zlrs_ram_sources
    ${zlrs_app_dir}/src/rf.c
    ${zlrs_app_dir}/src/platform/sha256.c
    ${zlrs_app_dir}/src/platform/lr2021.c
    ${zlrs_app_dir}/src/serial.c
    ${zlrs_app_dir}/src/power.c
    ${zlrs_app_dir}/src/band.c
    ${zlrs_app_dir}/src/link/link.c
    ${zlrs_app_dir}/src/link/handshake.c
    ${zlrs_app_dir}/src/link/data.c
    ${zlrs_app_dir}/src/proto/crypto.c
    ${zlrs_app_dir}/src/proto/frame.c
    ${zlrs_app_dir}/src/proto/fhss.c
  )
  if(CONFIG_ZLRS_RP2350_SHA256)
    list(APPEND zlrs_ram_sources
      ${zlrs_app_dir}/../drivers/crypto/rp2350_sha256.c
    )
  endif()
  zephyr_code_relocate(
    FILES
    ${zlrs_ram_sources}
    LOCATION RAM_TEXT
  )
endif()

# Make the application version depend on the git index so that APP_VERSION_STRING
# reflects the commit even when nothing else in the build changed.
find_package(Git QUIET)
if(GIT_FOUND)
  execute_process(
    COMMAND ${GIT_EXECUTABLE} rev-parse --absolute-git-dir
    WORKING_DIRECTORY "${zlrs_app_dir}"
    OUTPUT_VARIABLE application_git_dir
    OUTPUT_STRIP_TRAILING_WHITESPACE
    ERROR_QUIET
    RESULT_VARIABLE return_code
  )
  if(NOT return_code)
    set_property(TARGET app_version_h
                 PROPERTY APP_VERSION_DEPENDS ${application_git_dir}/index)
  endif()
endif()
```

## Kconfig
```
# Copyright (c) 2026 zlrs contributors
# SPDX-License-Identifier: Apache-2.0
#
# Application Kconfig entry point.

menu "Zephyr"
source "Kconfig.zephyr"
endmenu

menu "zlrs"


config ZLRS_APP_DEBUG
	bool "Development image (never ship this)"
	help
	  Marks an image built for the bench: it allows the ZLRS_APP_DEBUG_* options below, and
	  nothing that depends on it belongs in a production image. app/debug.conf sets it; the
	  configs that produce shipped images (app/prj.conf, boards/) must not mention it (CI gate).
	  See doc/10-debug.md.

menu "Hardware and product shape"

config ZLRS_APP_ROLE_LEADER
	bool "Default to the Leader role"
	default y
	help
	  Leader provides the clock and initiates pairing and sessions. Follower follows
	  the clock and responds. Both roles send and receive data.


# The only knob on the upgrade path: how long the host has to confirm. The mechanism itself
# (an image under MCUboot stays unconfirmed until the host says so, then either becomes
# permanent or is rolled back) has no switch — the board definition brings the image
# manager and the boot mode with it. See doc/06-firmware.md.
config ZLRS_APP_MCUBOOT_CONFIRM_TIMEOUT_MS
	int "Host confirm timeout (ms)"
	default 60000
	range 0 600000
	depends on BOOTLOADER_MCUBOOT
	help
	  No valid confirm command within this window means a reset and rollback. Leave enough time
	  for USB enumeration plus the tool. 0 = no wait (a host has to confirm immediately).


endmenu

menu "Runtime defaults and link parameters"

choice ZLRS_APP_SECURITY_PROFILE
	prompt "Over-the-air security profile"
	default ZLRS_APP_SECURITY_PROFILE_P1
	help
	  P1 is the production profile: a 4-byte tag on every frame. P0 carries no tag and is for
	  the bench only. See doc/08-security.md#cryptographic-parameters.

config ZLRS_APP_SECURITY_PROFILE_P0
	# Selecting P0 is a bench move (no tag at all), so only a debug image may do it.
	bool "P0: no tag (debug image only)" if ZLRS_APP_DEBUG

config ZLRS_APP_SECURITY_PROFILE_P1
	bool "P1: 4-byte tag (default)"

endchoice

config ZLRS_APP_DATA_RATE_BPS
	int "Data link rate (bps)"
	default 2600000

config ZLRS_APP_PACING_SCALE
	int "Superframe pacing scale (bench)"
	default 1
	range 1 8
	help
	  Multiplies the hardware timer superframe period. Both DATA slot boundaries and
	  radio deadlines follow the scaled period; radio work never stretches the schedule.

config ZLRS_APP_PREPARE_US
	int "Preparation time reserved before the next radio slot (us)"
	default 6000
	range 100 10000
	help
	  Wake before slot 0 and end each radio window early enough to prepare the next slot.
	  Packet construction, authentication, modem setup and FIFO loading run in this window.
	  Preserve the SubG frame plan independently of the SPI transfer engine.

config ZLRS_APP_DATA_24_PREPARE_US
	int "Preparation time for exclusive 2.4 GHz data slots (us)"
	default 1600
	range 100 10000
	help
	  Covers RX cleanup, packet authentication, modem setup and FIFO loading.
	  Validated with polling SPI under bidirectional load and peer pauses.
	  Both peers must use the same frame timing.

config ZLRS_APP_TX_GUARD_US
	int "Time from slot boundary to TX launch (us)"
	default 200
	range 100 10000
	help
	  The radio and FIFO are prepared ahead of the slot boundary. Only SET_TX runs at
	  this fixed offset; receivers enter RX as soon as their preparation is complete.

config ZLRS_APP_RESYNC_PERIOD_MS
	int "Periodic SYNC interval while connected (ms, 0 = off)"
	default 5000
	range 0 10000
	help
	  Once connected, send a SYNC on the sync channel this often: the peer re-aligns its hop
	  index (crystal drift accumulates into missed hops) and spots a peer reboot or re-pair.
	  See doc/07-protocol.md. Converted to frames, at least one.

config ZLRS_APP_MGMT_TIMEOUT_S
	int "Management mode idle timeout (s)"
	default 300
	help
	  Management mode exits after this long without a command, see doc/06-firmware.md.

endmenu

menu "Pending acceptance (see doc/11-roadmap.md)"

config ZLRS_APP_FHSS
	# These features are on in any image that goes on air; a debug image may switch one
	# off to isolate a layer (doc/10-debug.md), a production configuration cannot.
	bool "Per-frame frequency hopping" if ZLRS_APP_DEBUG
	default y
	help
	  With this off every frame stays on the sync channel (entry 0 of the hop table), which is
	  how layer isolation separates timing from the hop table. A fixed channel does not satisfy the
	  FCC 15.247 hopping rules: debug images only, see doc/07-protocol.md.

config ZLRS_APP_DATA_ARQ
	bool "Reliable data transfer (ARQ)" if ZLRS_APP_DEBUG
	default y
	help
	  On by default: the receiver flips the DATA body's ACK bit for each accepted data packet.
	  The sender waits for that flip before sending the next packet and retransmits on timeout.
	  Off means best-effort (drop when full, count it).
	  See doc/07-protocol.md.

config ZLRS_APP_DYNAMIC_POWER
	bool "Adapt DATA transmit power to quality reported by the peer" if ZLRS_APP_DEBUG
	default y
	help
	  DATA and ACK frames carry the receiver's RSSI and link quality. The transmitter
	  adjusts its own power at radio preparation boundaries within board and regional
	  limits. Pairing uses low power; recovery and missing feedback restore maximum.

config ZLRS_APP_WATCHDOG_TIMEOUT_MS
	int "Watchdog timeout (ms)"
	default 8000
	range 100 10000
	depends on WATCHDOG
	help
	  Has to cover the slowest feed interval (PBKDF2 inside management mode) without being too long.


endmenu

menu "Debug image (never in production)"
	depends on ZLRS_APP_DEBUG

config ZLRS_APP_DEBUG_TRACE
	bool "Bounded Zephyr CTF capture and Flash snapshots"
	depends on !SMP
	depends on TRACING_CTF && TRACING_SYNC && TRACING_BACKEND_RAM
	depends on TRACING_CTF_TIMESTAMP
	depends on FILE_SYSTEM_LITTLEFS && MCUMGR_GRP_FS
	depends on MCUMGR_TRANSPORT_UART && JSON_LIBRARY
	help
	  Record a manually started, time-limited interval using Zephyr's RAM
	  tracing backend. Save only at RF maintenance boundaries and export
	  committed snapshots through the MCUmgr filesystem group.

config ZLRS_APP_DEBUG_STATS_LOG
	bool "Status lines once a second on the console (bench debugging)"
	default n
	help
	  A few lines a second: frame counters, air-side failures, data drops, LQ,
	  region and duty. On for the bench, off in production
	  (it is noise). Logging only: the 1 Hz rate and power verdicts are unaffected.

config ZLRS_APP_DEBUG_BOOT_DELAY_MS
	int "Wait after USB comes up before continuing init (ms, 0 = no wait)"
	default 0
	range 0 30000
	help
	  Bench only: give the host time to open the console port (a CDC only transmits once the
	  host has opened it), so a panic during init is actually visible. Keep 0 in production.

config ZLRS_APP_DEBUG_LED_BRIGHTNESS_PERCENT
	int "Status LED brightness (percent)"
	default 1
	range 1 100
	help
	  Scales every status LED frame in a development image. Keep the debug LED dim on the bench;
	  production images use the core LED brightness levels without this debug-only attenuation.


endmenu
endmenu

module = APP
module-str = app
source "subsys/logging/Kconfig.template.log_config"
```

## sysbuild.conf
```
# Copyright (c) 2026 zlrs contributors
# SPDX-License-Identifier: Apache-2.0
#
# sysbuild settings, read by `west build --sysbuild`, which is how every image is built: the
# bootloader is part of the target (there is no bootloader-less variant to skip this).
#
# Usage (one bootloader target per sub-G SKU):
#   west build --sysbuild -b rp2350_zero_core2021/rp2350a/m33_0/hf app
#   west build --sysbuild -b rp2350_zero_core2021/rp2350a/m33_0/lf app

# Build MCUboot and propagate its operating mode to both images
SB_CONFIG_BOOTLOADER_MCUBOOT=y

# Swap using move needs no scratch partition. The shared flash layout is in
# boards/zlrs/rp2350_zero_core2021/rp2350_zero_core2021_partitions.dtsi.
# See doc/06-firmware.md for installation and rollback behavior.
SB_CONFIG_MCUBOOT_MODE_SWAP_USING_MOVE=y

# Image signing: ECDSA-P256. sysbuild hands the type and key to the bootloader (verify) and
# the application (sign) together, so they cannot drift apart. Development keeps MCUboot's
# bundled test key (the default is root-ec-p256.pem from the mcuboot tree).
#
# **Replace this with your own key before production**:
#   python bootloader/mcuboot/scripts/imgtool.py genkey -k zlrs-prod.pem -t ecdsa-p256
# then add SB_CONFIG_BOOT_SIGNATURE_KEY_FILE="<private key path>" (never commit the key)
# and reflash the bootloader: the public key lives inside it, so a new key means a reflash.
SB_CONFIG_BOOT_SIGNATURE_TYPE_ECDSA_P256=y
```

## prj.conf
```kconfig
# Copyright (c) 2026 zlrs contributors
# SPDX-License-Identifier: Apache-2.0
#
# USP supplies the LR20xx RAL driver and Zephyr HAL. The application owns the radio;
# RAC/planner and the USP main thread are not started. No LoRaWAN stack is enabled.

# ------------------------------ General ---------------------------------------
CONFIG_HEAP_MEM_POOL_SIZE=4096
CONFIG_LOG=y
CONFIG_PM_DEVICE=y
# Hardware watchdog, armed in every image (app/src/platform/watchdog.c): a hang becomes a reset,
# and on an image the host has not confirmed yet that reset is MCUboot's rollback.
CONFIG_WATCHDOG=y
CONFIG_RESET_ON_FATAL_ERROR=y
CONFIG_INPUT=y
CONFIG_FLASH=y
CONFIG_COUNTER=y
# On-demand MCU die temperature in status.
CONFIG_SENSOR=y
CONFIG_CPU_LOAD=y
# Timer ISR entry must not fetch its vector through XIP Flash.
CONFIG_SRAM_VECTOR_TABLE=y

# Short LR2021 SPI commands use polling to avoid per-transfer DMA setup and
# completion wakeups in the fixed preparation window. The one-pixel PIO LED
# also writes directly to its FIFO; neither path needs the DMA driver.
CONFIG_DMA=n
CONFIG_SPI_PL022_DMA=n

# Zephyr selects the SHA-256 driver from the enabled devicetree peripheral.
CONFIG_CRYPTO=y

# Application side: NVS for keys and pairing, and the flash map the partitions describe
# (the UARTs, GPIO and the USB stack come from the board, shared with the bootloader)
CONFIG_NVS=y
CONFIG_SETTINGS=y
CONFIG_SETTINGS_NVS=y
CONFIG_FLASH_MAP=y

# The entropy source initialises after the hardware watchdog (PRE_KERNEL_1 + 51): its probe
# touches TRNG registers, and if that hangs the CPU the watchdog can still reset the board.
# Zephyr's cryptographic random API reads this device directly; no PSA provider is needed.
CONFIG_ENTROPY_INIT_PRIORITY=60
CONFIG_CSPRNG_NEEDED=y

# Two CDCs: data and management. The stack itself and the CDC class come from the board
# (boards/…/Kconfig.defconfig, shared with the MCUboot image); subsys/usb builds its own usbd
# context, so Zephyr's register-only-the-first-CDC helper stays off.
CONFIG_CDC_ACM_SERIAL_INITIALIZE_AT_BOOT=n

# INFO dumps every received payload and logs FIFO wakeups. Keep normal CDC traffic
# out of the deferred log queue and log export's rotating files.
CONFIG_USBD_CDC_ACM_LOG_LEVEL_WRN=y

# The application takes part in the upgrade: it confirms the image the host approved, checks the
# confirm bit at boot and lets MCUboot roll back a build that never came up (doc/06-firmware.md).
# The bootloader's side of the same machinery is in app/sysbuild/mcuboot.conf.
CONFIG_IMG_MANAGER=y
CONFIG_STREAM_FLASH=y

# Kernel timeouts use 1 ms ticks; TIMER1 schedules RF independently at microsecond resolution.
CONFIG_SYS_CLOCK_TICKS_PER_SEC=1000


# ------------------------------ radio stack -----------------------------------
CONFIG_LORA_BASICS_MODEM_DRIVERS=y
CONFIG_LORA_BASICS_MODEM_DRIVERS_EVENT_TRIGGER_NO_THREAD=y
# The vendor default is 600000 (ten minutes): a radio that never raises BUSY would spin on the
# main thread for that long, starving the watchdog feed. One second covers the radio's own
# wake-up and calibration. The unmodified upstream HAL raises k_oops on timeout;
# the watchdog resets the board if radio access cannot recover.
CONFIG_LORA_BASICS_MODEM_DRIVERS_HAL_WAIT_ON_BUSY_TIMEOUT_MSEC=1000

CONFIG_USP=y
CONFIG_USP_MAIN_THREAD=n
# Keep unused USP layers quiet; radio diagnostics come from the application port.
CONFIG_USP_LOG_LEVEL_WRN=y

# ------------------------------ threading model -------------------------------
# Main owns the data link and radio preparation/completion (doc/05-architecture.md).
# The RF owner raises its runtime priority after initialization; management uses this priority.
CONFIG_MAIN_THREAD_PRIORITY=-2
# The RF owner can preempt cooperative USB workers while servicing hardware events.
CONFIG_NUM_METAIRQ_PRIORITIES=1
# TIMER1 alarm 3 issues the prepared SET_TX command independently of kernel IRQ locks.
CONFIG_ZERO_LATENCY_IRQS=y
# Keep upstream CDC worker scheduling; integration stays inside ZLRS.

CONFIG_MAIN_STACK_SIZE=4096
CONFIG_THREAD_NAME=y

# ------------------------------ zlrs ------------------------------------------
# RF code executes from SRAM to meet preparation and launch deadlines.
CONFIG_CODE_DATA_RELOCATION=y

# The USB device stack (subsys/usb) belongs in the application image: it builds the usbd context
# and registers every CDC; the bootloader's copy is enabled in sysbuild/mcuboot.conf.
CONFIG_ZLRS_USB=y
# The callback only updates atomic host facts. Avoid deferred notification loss
# or stale selection behind CDC line-control messages on the system workqueue.
CONFIG_USBD_MSG_DEFERRED_MODE=n

# Status LED: the strip API is part of every image and devicetree picks the driver behind it —
# the on-board WS2812 here runs on PIO. A board without a `zlrs-led` alias has no device and the
# LED thread simply has nothing to show (app/src/ui.c).
CONFIG_LED_STRIP=y
# The LED is its own thread and the system state rides zbus: producers publish what the device is
# doing (RF link/alerts and management mode), and the LED thread decides how to show it
# (app/src/ui.c, doc/09-ux.md). ZBUS is the only bus in the image, and it is what keeps
# the strip write out of the superframe.
CONFIG_ZBUS=y

# ------------------------------ diagnostics -----------------------------------
# The log is kept in flash as well as printed: Zephyr's file-logging backend writes the same
# stream to a power-fail-safe LittleFS on log_partition, rotating files so the oldest are
# overwritten (that is the ring), and the console keeps working as before (doc/06-firmware.md).
CONFIG_FILE_SYSTEM=y
CONFIG_FILE_SYSTEM_LITTLEFS=y
CONFIG_FLASH_PAGE_LAYOUT=y
# Read flash around the XIP cache, or a read after a write can return the line cached before it
# (LittleFS then mounts "corrupted", NVS silently reverts). Set by the board for both images.
CONFIG_LOG_BACKEND_FS=y
CONFIG_LOG_BACKEND_FS_DIR="/lfs"
CONFIG_LOG_BACKEND_FS_FILE_PREFIX="log."
# The ring is FILE_SIZE × FILES_LIMIT = 1 MB, which has to be the log_partition in
# boards/…/rp2350_zero_core2021_partitions.dtsi; CI checks the arithmetic.
CONFIG_LOG_BACKEND_FS_FILE_SIZE=131072
CONFIG_LOG_BACKEND_FS_FILES_LIMIT=8
CONFIG_LOG_BACKEND_FS_OVERWRITE=y
CONFIG_LOG_BACKEND_FS_APPEND_TO_NEWEST_FILE=y
# Flash writes mask RP2350 IRQs. Queue logs in RAM during RF operation and drain only at boot
# or in management mode, where radio work is paused. Overflow retains the newest messages.
CONFIG_LOG_PROCESS_THREAD=n
CONFIG_LOG_BUFFER_SIZE=8192
CONFIG_LOG_MODE_OVERFLOW=y
# Backends initialize at boot; messages are processed only after the application starts,
# by which time app/src/log.c has mounted the file system (POST_KERNEL 100).
CONFIG_LOG_CORE_INIT_PRIORITY=90

# A fatal error leaves its registers and stacks in coredump_partition; decode it offline with
# scripts/coredump (doc/10-debug.md). It is not written from the faulting context itself.
CONFIG_DEBUG_COREDUMP=y
CONFIG_DEBUG_COREDUMP_BACKEND_FLASH_PARTITION=y
CONFIG_DEBUG_COREDUMP_MEMORY_DUMP_THREADS=y

# Reset cause for the boot record in the log (hwinfo_rpi_pico)
CONFIG_HWINFO=y

# Native management transport and standard OS / image / read-only filesystem groups.
# Zephyr's UART MCUmgr driver lives under CONSOLE; kernel UART output stays debug-only.
CONFIG_CONSOLE=y
CONFIG_UART_CONSOLE=n
CONFIG_NET_BUF=y
CONFIG_ZCBOR=y
CONFIG_MCUMGR=y
CONFIG_BASE64=y
CONFIG_CRC=y
CONFIG_UART_MCUMGR=y
CONFIG_MCUMGR_TRANSPORT_UART=y
CONFIG_MCUMGR_TRANSPORT_WORKQUEUE_THREAD_PRIO=3
CONFIG_MCUMGR_TRANSPORT_WORKQUEUE_STACK_SIZE=4096
CONFIG_MCUMGR_TRANSPORT_NETBUF_SIZE=8192
CONFIG_MCUMGR_TRANSPORT_NETBUF_COUNT=2
CONFIG_MCUMGR_GRP_OS=y
CONFIG_MCUMGR_GRP_OS_INFO=y
CONFIG_MCUMGR_GRP_OS_INFO_CUSTOM_HOOKS=y
CONFIG_MCUMGR_GRP_OS_INFO_MAX_RESPONSE_SIZE=256
CONFIG_MCUMGR_GRP_OS_MCUMGR_PARAMS=y
CONFIG_MCUMGR_GRP_OS_RESET_HOOK=y
CONFIG_MCUMGR_GRP_OS_RESET_BOOT_MODE=y
CONFIG_MCUMGR_GRP_IMG=y
CONFIG_MCUMGR_GRP_IMG_ALLOW_CONFIRM_NON_ACTIVE_SLOT=n
CONFIG_MCUMGR_GRP_FS=y
CONFIG_MCUMGR_GRP_FS_MAX_FILE_SIZE_4GB=y
# FS keeps one download chunk on the SMP worker stack.
CONFIG_MCUMGR_GRP_FS_DL_CHUNK_SIZE_LIMIT=y
CONFIG_MCUMGR_GRP_FS_DL_CHUNK_SIZE=256
CONFIG_MCUMGR_GRP_FS_FILE_ACCESS_HOOK=y
CONFIG_MCUMGR_MGMT_NOTIFICATION_HOOKS=y
CONFIG_MCUMGR_SMP_COMMAND_STATUS_HOOKS=y
CONFIG_MCUMGR_GRP_FS_FILE_AUTOMATIC_IDLE_CLOSE_TIME=100
```

## bringup-noradio.conf
```kconfig
# Copyright (c) 2026 zlrs contributors
# SPDX-License-Identifier: Apache-2.0
#
# Use this while no Core2021 is attached: the radio sits out entirely (app/src/radio_null.c)
# and everything else (USB, config port, status LED, CRSF, entropy, NVS) is normal.
#
#   west build --sysbuild -b "$ZLRS_BOARD" "$ZLRS_APP" -- \
#     -DEXTRA_CONF_FILE="$ZLRS_REPO_ROOT/app/debug.conf;$ZLRS_REPO_ROOT/app/bringup-noradio.conf" \
#     -DDTC_OVERLAY_FILE="$ZLRS_REPO_ROOT/app/debug.overlay"
#
# Note: with the radio enabled and no module attached, the vendored lr20xx HAL spins
# waiting for BUSY (600 s default, then k_oops), leaving the board dark and USB dead —
# that is the driver's doing. Use this config for anything that does not test the radio.

# Turning the radio off is a debug-image option (app/Kconfig), so this file marks the image
# as one; on its own it is a bench image, not something to ship.
CONFIG_ZLRS_APP_DEBUG=y

CONFIG_ZLRS_APP_RADIO=n
```

## control24-debug.conf
```kconfig
# Combine with debug.conf and debug.overlay. P1 and authenticated sessions remain enabled.
CONFIG_ZLRS_APP_LINK_CONTROL=y
CONFIG_ZLRS_APP_LINK_DATA=n
CONFIG_ZLRS_APP_BAND_ROLE_SUBG_DATA=y
CONFIG_ZLRS_APP_CONTROL_1KHZ=y
CONFIG_ZLRS_APP_RACING_CONTROL_RATE_HZ=1000
CONFIG_ZLRS_APP_PREPARE_US=300
CONFIG_ZLRS_APP_TX_GUARD_US=100
CONFIG_ZLRS_APP_SUB_BAND_MIX=n
CONFIG_ZLRS_APP_FHSS=n
CONFIG_ZLRS_APP_TELEMETRY=n
```

## data24-debug.conf
```kconfig
# Bench isolation: only the 2.4 GHz data link uses the radio.
# Combine with app/debug.conf and app/debug.overlay on either LF or HF hardware.
# Pairing runs on the 2.4 GHz data link; no existing pairing record is required.
CONFIG_ZLRS_APP_LINK_CONTROL=n
CONFIG_ZLRS_APP_LINK_DATA=y
CONFIG_ZLRS_APP_BAND_ROLE_SUBG_CONTROL=y
CONFIG_ZLRS_APP_SUB_BAND_MIX=n
# Keep the data channel fixed while diagnosing slot timing. Authentication, the
# session handshake and ARQ remain enabled.
CONFIG_ZLRS_APP_FHSS=n
# Fixed-channel profiling uses the validated 1 ms preparation window. Production
# keeps its separate 1.5 ms default; shorter windows still miss fallback preparation.
CONFIG_ZLRS_APP_DATA24_PREPARE_US=1000
```

## debug.conf
```kconfig
# Copyright (c) 2026 zlrs contributors
# SPDX-License-Identifier: Apache-2.0
#
# Extra configuration for development builds:
#   west build --sysbuild -b "$ZLRS_BOARD" "$ZLRS_APP" \
#     -- -DEXTRA_CONF_FILE="$ZLRS_REPO_ROOT/app/debug.conf" \
#        -DDTC_OVERLAY_FILE="$ZLRS_REPO_ROOT/app/debug.overlay"
#
# Enables UART kernel output, deferred logging and diagnostics. Production
# images have none of this (doc/10-debug.md); prj.conf already covers LOG, THREAD_NAME...

# This is a development image: it may use the ZLRS_APP_DEBUG_* options, and nothing that
# needs them may appear in a shipped configuration (checked by CI).
CONFIG_ZLRS_APP_DEBUG=y

# Logs remain in RAM while RF runs and flush at boot or during management mode. This avoids
# flash writes masking timer IRQs. The fault itself is also covered by the coredump.
CONFIG_ASSERT=y

# Keep UART console and kernel output; command parsing stays disabled.
CONFIG_SHELL=n
CONFIG_CONSOLE=y
CONFIG_UART_CONSOLE=y
CONFIG_PRINTK=y
CONFIG_LOG_PRINTK=y
CONFIG_LOG_BACKEND_UART=y

# Keep the development image's status pixel dim while it runs on the bench.
CONFIG_ZLRS_APP_DEBUG_LED_BRIGHTNESS_PERCENT=1
```

## trace-debug.conf
```kconfig
# SPDX-License-Identifier: Apache-2.0
# Apply after app/debug.conf, with app/debug.overlay.
# Leave enough time to export an unconfirmed bench image before rollback.
CONFIG_ZLRS_APP_MCUBOOT_CONFIRM_TIMEOUT_MS=600000
CONFIG_MAIN_STACK_SIZE=8192
CONFIG_TRACING=y
CONFIG_TRACING_CTF=y
CONFIG_TRACING_SYNC=y
CONFIG_TRACING_BACKEND_RAM=y
CONFIG_RAM_TRACING_BUFFER_SIZE=65536
CONFIG_TRACING_HANDLE_HOST_CMD=y
CONFIG_TRACING_SHELL=n
CONFIG_TRACING_THREAD=y
CONFIG_TRACING_ISR=y
CONFIG_TRACING_SEMAPHORE=y
CONFIG_TRACING_IDLE=y
CONFIG_TRACING_GPIO=n
CONFIG_TRACING_SYSCALL=n
CONFIG_TRACING_WORK=n
CONFIG_TRACING_MUTEX=n
CONFIG_TRACING_CONDVAR=n
CONFIG_TRACING_QUEUE=n
CONFIG_TRACING_FIFO=n
CONFIG_TRACING_LIFO=n
CONFIG_TRACING_STACK=n
CONFIG_TRACING_MESSAGE_QUEUE=n
CONFIG_TRACING_MAILBOX=n
CONFIG_TRACING_PIPE=n
CONFIG_TRACING_HEAP=n
CONFIG_TRACING_MEMORY_SLAB=n
CONFIG_TRACING_TIMER=n
CONFIG_TRACING_EVENT=n
CONFIG_TRACING_POLLING=n
CONFIG_TRACING_PM=n

CONFIG_JSON_LIBRARY=y
CONFIG_ZLRS_APP_DEBUG_TRACE=y
```

## debug.overlay
```dts
/*
 * Copyright (c) 2026 zlrs contributors
 *
 * SPDX-License-Identifier: Apache-2.0
 *
 * Devicetree overlay for debug builds: enable the console CDC the board keeps disabled
 * (cdc_acm_uart2; UART console and kernel logs).
 *
 *   west build ... -- -DEXTRA_CONF_FILE=app/debug.conf \
 *                     -DDTC_OVERLAY_FILE=app/debug.overlay
 */

&cdc_acm_uart2 {
	status = "okay";
	/* Keep space for UART kernel logs. */
	tx-fifo-size = <8192>;
	hw-flow-control;
};
```

## src/main.c
```c
/* SPDX-License-Identifier: Apache-2.0 */

#include <zephyr/kernel.h>
#include <zephyr/logging/log.h>
#include <zephyr/logging/log_ctrl.h>

#include <errno.h>

#include "lifecycle.h"
#include "log.h"
#include "mgmt.h"
#include "persist.h"
#include "platform/watchdog.h"
#include "rf.h"
#include "serial.h"
#include "trace.h"
#include "ui.h"

LOG_MODULE_REGISTER(zlrs_main, CONFIG_APP_LOG_LEVEL);

/* A physical request must not start pairing long after the user has left. */
#define PAIR_REQUEST_WAIT_MS 30000U

static void save_pairing(zlrs_pairing_save_t *state)
{
	const zlrs_link_status_t *link = zlrs_rf_state()->link;
	const zlrs_pairing_t *pairing = link->paired ? &link->pairing : NULL;
	const zlrs_persist_state_t *saved = zlrs_persist_state();
	if (!zlrs_pairing_save_due(state, pairing, saved->paired ? &saved->pairing : NULL,
				   k_uptime_get_32())) {
		return;
	}
	zlrs_rf_pause();
	const int rc = zlrs_persist_save_pairing(pairing);
	zlrs_rf_resume();
	const uint32_t retry_ms = zlrs_pairing_save_complete(state, rc == 0, k_uptime_get_32());
	if (rc == 0) {
		LOG_INF("paired with %02x%02x%02x%02x", pairing->peer_id[0], pairing->peer_id[1],
			pairing->peer_id[2], pairing->peer_id[3]);
	} else {
		LOG_ERR("pairing save failed (%d); retry in %u ms", rc, retry_ms);
	}
}

int main(void)
{
	const int persist_rc = zlrs_persist_init();
	const bool rf_ready = persist_rc == 0 && zlrs_rf_init() == 0;
	if (rf_ready) {
		(void)zlrs_serial_init(zlrs_persist_state()->settings.data_baud);
	} else {
		LOG_ERR("fault state: not transmitting; management port stays available for "
			"flashing");
	}
	zlrs_log_console_sync();
	log_flush();
	if (rf_ready) {
		zlrs_rf_start();
	}
	uint32_t button_holds_seen = 0U;
	bool pair_requested = false;
	uint32_t pair_requested_at = 0U;
	zlrs_pairing_save_t pairing_save = {0};

	for (;;) {
		zlrs_watchdog_feed();
		zlrs_rf_publish_state(false);
		zlrs_serial_publish_state();
		zlrs_lifecycle_check_rollback(!rf_ready,
					      CONFIG_ZLRS_APP_MCUBOOT_CONFIRM_TIMEOUT_MS);
		zlrs_trace_process(false);
		if (zlrs_mgmt_process()) {
			/* Explicit management commands supersede a waiting button request. */
			pair_requested = false;
			continue;
		}
		struct zlrs_input asked;
		if (zbus_chan_read(&zlrs_input_chan, &asked, K_NO_WAIT) == 0 &&
		    asked.button_holds != button_holds_seen) {
			button_holds_seen = asked.button_holds;
			pair_requested = zlrs_button_pairing_allowed();
			pair_requested_at = k_uptime_get_32();
		}
		if (pair_requested) {
			if (!zlrs_button_pairing_allowed() ||
			    (uint32_t)(k_uptime_get_32() - pair_requested_at) >=
				    PAIR_REQUEST_WAIT_MS ||
			    zlrs_rf_pair_start() != -EAGAIN) {
				pair_requested = false;
			}
		}
		if (rf_ready) {
			zlrs_rf_frame();
			save_pairing(&pairing_save);
		} else {
			k_msleep(20);
		}
	}
}
```

## src/band.c
```c
/* SPDX-License-Identifier: Apache-2.0 */
#include "band.h"
#include <zephyr/sys/util.h>

void zlrs_band_policy_init(zlrs_band_policy_t *p, zlrs_role_t role, uint32_t duty_window_ms,
			   uint32_t now_ms)
{
	*p = (zlrs_band_policy_t){
		.loss_ms = MAX(1500U, duty_window_ms ? duty_window_ms + 2000U : 0U),
		/* Leader holds one profile longer than a complete Follower sweep. */
		.dwell_ms = (role == ZLRS_ROLE_LEADER ? ZLRS_PHY_AUTO_COUNT + 2U : 1U) *
			    MAX(4000U, duty_window_ms ? duty_window_ms + 2000U : 0U),
		.entered_ms = now_ms,
		.contact_ms = now_ms};
}

static zlrs_band_action_t next_profile(zlrs_band_policy_t *p, const zlrs_link_cfg_t *cfg,
				       zlrs_band_action_t action)
{
	p->target_subg = false;
	if (cfg->region != ZLRS_REGION_ISM2400) {
		/* Probe the most robust 2.4 GHz profile before recovering throughput. */
		p->target_phy = action == ZLRS_BAND_PLAN ? ZLRS_PHY_LORA_SF7 : ZLRS_PHY_FLRC_2600;
	} else if (cfg->phy + 1U < ZLRS_PHY_AUTO_COUNT) {
		p->target_phy = cfg->phy + 1U;
	} else {
		p->target_subg = true;
		p->target_phy = ZLRS_PHY_FLRC_2600;
	}
	return action;
}

void zlrs_band_policy_reset(zlrs_band_policy_t *p, bool probe, uint32_t now_ms, uint32_t last_rx_ms)
{
	p->probing = probe;
	p->entered_ms = p->contact_ms = now_ms;
	p->last_rx_ms = last_rx_ms;
	p->stable.active = p->bad.active = p->good.active = false;
	p->power_boosted = false;
	p->maximum = false;
	p->quality[0].windows = p->quality[1].windows = 0U;
}

zlrs_band_action_t zlrs_band_policy_update(zlrs_band_policy_t *p, const zlrs_link_observation_t *o,
					   const zlrs_power_t *power)
{
	const zlrs_link_status_t *link = o->link;
	const zlrs_link_cfg_t *cfg = &link->cfg;
	const bool subg = cfg->region != ZLRS_REGION_ISM2400;
	const uint32_t settle_ms = o->settle_ms;
	const bool power_at_max = link->cfg.tx_power_dbm >= power->ceiling_dbm;

	if (!cfg->automatic_band || !link->paired || (link->state == ZLRS_STATE_PAIRING)) {
		zlrs_band_policy_reset(p, p->probing, o->now_ms, link->last_rx_ms);
		return ZLRS_BAND_KEEP;
	}
	if (link->last_rx_ms != p->last_rx_ms) {
		p->last_rx_ms = link->last_rx_ms;
		p->contact_ms = o->now_ms;
	}
	if (link->radio_acquiring) {
		p->stable.active = p->bad.active = p->good.active = false;
		p->power_boosted = false;
		if ((uint32_t)(o->now_ms - p->entered_ms) >=
		    (p->probing ? p->loss_ms : p->dwell_ms)) {
			return next_profile(p, cfg, ZLRS_BAND_SEARCH);
		}
		return ZLRS_BAND_KEEP;
	}
	if ((uint32_t)(o->now_ms - p->contact_ms) >= p->loss_ms) {
		return next_profile(p, cfg, ZLRS_BAND_SEARCH);
	}
	if (!(link->session_valid && link->state == ZLRS_STATE_CONNECTED) ||
	    (link->band_plan.switch_frame != 0U)) {
		p->bad.active = p->good.active = false;
		return ZLRS_BAND_KEEP;
	}
	const bool fresh = link->last_peer_feedback_ms != 0U &&
			   (uint32_t)(o->now_ms - link->last_peer_feedback_ms) < p->loss_ms &&
			   link->stats.last_rssi != 0 && link->peer_rssi_dbm != 0;
	const int16_t floor = zlrs_band_rssi_floor(subg, cfg->phy);
	const bool weak = fresh && (link->stats.last_rssi < floor || link->peer_rssi_dbm < floor);
	/* Only a complete post-maximum window can prove that more power did not help.
	 * Discard the first boundary, whose window may contain lower-power attempts. */
	if (!fresh || !power_at_max) {
		p->maximum = false;
		p->quality[0].windows = p->quality[1].windows = 0U;
	} else {
		const bool reset = !p->maximum || p->power_changed_ms != power->last_change_ms;
		if (reset) {
			p->maximum = true;
			p->maximum_ms = o->now_ms;
			p->power_changed_ms = power->last_change_ms;
		}
		const uint32_t generations[] = {link->stats.lq_generation,
						link->peer_lq_generation};
		const bool settled = (uint32_t)(o->now_ms - p->maximum_ms) >= settle_ms;
		for (size_t i = 0U; i < ARRAY_SIZE(p->quality); i++) {
			const uint32_t delta = generations[i] - p->quality[i].generation;
			if (reset || delta > 1U) {
				p->quality[i].windows = 0U;
			} else if (delta == 1U && settled && p->quality[i].windows < 2U) {
				p->quality[i].windows++;
			}
			p->quality[i].generation = generations[i];
		}
	}
	const bool quality_poor = fresh && p->maximum &&
				  ((p->quality[0].windows >= 2U && link->stats.lq_percent < 95U) ||
				   (p->quality[1].windows >= 2U && link->peer_lq_percent < 95U));
	const bool poor = weak || quality_poor;
	const int16_t upgrade_floor =
		subg || cfg->phy == 0U ? floor : zlrs_band_rssi_floor(false, cfg->phy - 1U) + 6;
	const bool quality_healthy = link->stats.lq_percent >= 95U &&
				     link->stats.lq_percent <= 100U &&
				     link->peer_lq_percent >= 95U && link->peer_lq_percent <= 100U;
	const bool upgrade = fresh && !poor && quality_healthy &&
			     link->stats.last_rssi >= upgrade_floor &&
			     link->peer_rssi_dbm >= upgrade_floor;
	/* Both roles react to either weak direction before the Leader may downgrade.
	 * Reverse DATA already reports the weak reception to the other endpoint. */
	if (!subg && weak) {
		p->stable.active = p->good.active = false;
		if (!p->power_boosted || !power_at_max) {
			p->power_boosted = true;
			p->power_boost_ms = o->now_ms;
			p->bad.active = false;
			return ZLRS_BAND_BOOST;
		}
		/* Repeated pre-boost observations cannot qualify a downgrade. */
		if ((int32_t)(link->last_peer_feedback_ms - p->power_boost_ms) <=
			    (int32_t)settle_ms ||
		    (int32_t)(link->last_rx_ms - p->power_boost_ms) <= (int32_t)settle_ms) {
			p->bad.active = false;
			return ZLRS_BAND_KEEP;
		}
	} else if (fresh) {
		p->power_boosted = false;
	}
	const bool stable = zlrs_hold_reached(&p->stable, upgrade, o->now_ms, 60000U);
	const bool good =
		zlrs_hold_reached(&p->good, fresh && !poor && quality_healthy, o->now_ms, 5000U);
	const bool bad = zlrs_hold_reached(&p->bad, poor, o->now_ms, 2000U);
	if (p->probing && good) {
		p->probing = false;
	}
	if (cfg->role != ZLRS_ROLE_LEADER) {
		return ZLRS_BAND_KEEP;
	}
	if (!subg && (quality_poor || bad)) {
		return next_profile(p, cfg, ZLRS_BAND_PLAN);
	}
	if (stable) {
		if (cfg->region != ZLRS_REGION_ISM2400) {
			return next_profile(p, cfg, ZLRS_BAND_PLAN);
		}
		if (cfg->phy > 0U) {
			p->target_subg = false;
			p->target_phy = cfg->phy - 1U;
			return ZLRS_BAND_PLAN;
		}
	}
	return ZLRS_BAND_KEEP;
}

/* Initial 10 dB receive margins; calibrate against equal-length packet error curves. */
int16_t zlrs_band_rssi_floor(bool subg, zlrs_phy_t phy)
{
	return subg ? -95 : zlrs_phys[phy < ZLRS_PHY_AUTO_COUNT ? phy : 0U].rssi_floor_dbm;
}
```

## src/band.h
```c
/* Automatic frequency-band policy; clocks and radio operations belong to RF.
 * SPDX-License-Identifier: Apache-2.0 */
#pragma once

#include <stdbool.h>
#include <stdint.h>

#include "power.h"
#include "proto/limits.h"
#include "proto/mod.h"

typedef enum {
	ZLRS_BAND_KEEP,
	ZLRS_BAND_PLAN,
	ZLRS_BAND_SEARCH,
	ZLRS_BAND_BOOST
} zlrs_band_action_t;

typedef struct {
	bool probing;
	zlrs_phy_t target_phy;
	bool target_subg;
	uint32_t loss_ms, dwell_ms, entered_ms, contact_ms, last_rx_ms;
	zlrs_hold_t stable, bad, good;
	bool power_boosted;
	uint32_t power_boost_ms;
	bool maximum;
	uint32_t maximum_ms, power_changed_ms;

	struct {
		uint32_t generation;
		uint8_t windows;
	} quality[2];
} zlrs_band_policy_t;

void zlrs_band_policy_init(zlrs_band_policy_t *policy, zlrs_role_t role, uint32_t duty_window_ms,
			   uint32_t now_ms);
void zlrs_band_policy_reset(zlrs_band_policy_t *policy, bool probe, uint32_t now_ms,
			    uint32_t last_rx_ms);
zlrs_band_action_t zlrs_band_policy_update(zlrs_band_policy_t *policy,
					   const zlrs_link_observation_t *observation,
					   const zlrs_power_t *power);

/* Initial per-PHY receive boundary, shared with transmit-power control. */
int16_t zlrs_band_rssi_floor(bool subg, zlrs_phy_t phy);
```

## src/board.h
```c
/*
 * Board-derived values: what this board is, read from the devicetree.
 *
 * SPDX-License-Identifier: Apache-2.0
 */

#pragma once

#include <zephyr/devicetree.h>

#include "zlrs/region/region.h"

/* Local sub-G SKU (declared in each variant's dtsi); the region has to match it, see core/region.
 * It must come from a DT node: DT macros cannot read custom-prefixed /chosen properties. */
#define ZLRS_SUBG_BAND DT_PROP(DT_NODELABEL(zlrs_subg_band), band)
```

## src/boot.c
```c
/* SPDX-License-Identifier: Apache-2.0 */

#include "boot.h"

#include <zephyr/dfu/mcuboot.h>
#include <zephyr/kernel.h>
#include <zephyr/logging/log.h>
#include <zephyr/sys/reboot.h>

LOG_MODULE_REGISTER(zlrs_boot, CONFIG_APP_LOG_LEVEL);

static bool confirmed;

void zlrs_boot_check_rollback(bool fault)
{
	if (confirmed) {
		return;
	}
	if (boot_is_img_confirmed()) {
		confirmed = true;
		return;
	}
	if (fault) {
		LOG_ERR("fault on unconfirmed image: rebooting to roll back");
		k_msleep(2000);
		sys_reboot(SYS_REBOOT_COLD);
	} else if (k_uptime_get_32() >= (uint32_t)CONFIG_ZLRS_APP_MCUBOOT_CONFIRM_TIMEOUT_MS) {
		LOG_ERR("upgrade not confirmed by host: rebooting to roll back");
		sys_reboot(SYS_REBOOT_COLD);
	}
}
```

## src/boot.h
```c
/* SPDX-License-Identifier: Apache-2.0 */
#pragma once

#include <stdbool.h>

/* Reboot an unconfirmed image on startup fault or host confirmation timeout. */
void zlrs_boot_check_rollback(bool fault);
```

## src/caps.h
```c
/*
 * What this hardware is, derived from devicetree (doc/08-firmware.md 4).
 *
 * This header is the only place in the application that reads aliases and the
 * radio-design node, and the only place that may name them. Everything else
 * asks these macros, so a new board is a devicetree change, never a C change.
 *
 * A feature the hardware cannot carry fails the build here instead of
 * misbehaving in the field.
 *
 * SPDX-License-Identifier: Apache-2.0
 */

#pragma once

#include <zephyr/devicetree.h>
#include <zephyr/sys/util.h>

#include "zlrs/region/region.h"

/* ---- ports: one UART plus one CDC per logical port, both optional ---- */
#define ZLRS_PORT_CTRL_FIXED                                                                      \
	(DT_NODE_EXISTS(DT_ALIAS(zlrs_control_uart)) ||                                           \
	 DT_NODE_EXISTS(DT_ALIAS(zlrs_control_cdc)))
#define ZLRS_PORT_DATA_FIXED                                                                      \
	(DT_NODE_EXISTS(DT_ALIAS(zlrs_data_uart)) || DT_NODE_EXISTS(DT_ALIAS(zlrs_data_cdc)))
#define ZLRS_PORT_CONFIG DT_NODE_EXISTS(DT_ALIAS(zlrs_config_cdc))

/* ---- peripherals ---- */
#define ZLRS_HAS_BUTTON DT_NODE_EXISTS(DT_ALIAS(zlrs_button))
#define ZLRS_HAS_LED DT_NODE_EXISTS(DT_ALIAS(zlrs_led))
/* A strip is only usable when the driver and the pattern engine are in the build too: trimming
 * the driver while leaving the alias makes DEVICE_DT_GET reference a device that does not exist
 * (doc/08-firmware.md 4). */
#define ZLRS_LED_COMPILED (IS_ENABLED(CONFIG_LED_STRIP) && IS_ENABLED(CONFIG_ZLRS_LED))
#define ZLRS_LED_AVAILABLE (ZLRS_HAS_LED && ZLRS_LED_COMPILED)
#define ZLRS_HAS_WDT DT_NODE_EXISTS(DT_ALIAS(watchdog0))
#define ZLRS_HAS_NVS IS_ENABLED(CONFIG_NVS)
#define ZLRS_HAS_USB IS_ENABLED(CONFIG_ZLRS_USB)

/* ---- radio design: band and the frequency coverage the PA network is built for ---- */
#define ZLRS_RF_BAND DT_PROP(DT_NODELABEL(zlrs_rf), band)
#define ZLRS_RF_LOW_HZ DT_PROP(DT_NODELABEL(zlrs_rf), low_hz)
#define ZLRS_RF_HIGH_HZ DT_PROP(DT_NODELABEL(zlrs_rf), high_hz)
/* Region a fresh board boots with; the config protocol overwrites it in NVS */
#define ZLRS_DEFAULT_REGION DT_PROP(DT_NODELABEL(zlrs_rf), default_region)
#define ZLRS_RF_DESIGN                                                                             \
	(&(const zlrs_rf_design_t){                                                                \
		.band = ZLRS_RF_BAND, .low_hz = ZLRS_RF_LOW_HZ, .high_hz = ZLRS_RF_HIGH_HZ})

/* ---- capabilities the software insists on ---- */
#if !ZLRS_HAS_NVS
#error "zlrs keeps keys, pairing and failsafe values in NVS; a board without NVS is not supported"
#endif

#if IS_ENABLED(CONFIG_ZLRS_APP_LINK_CONTROL) && !ZLRS_PORT_CTRL_FIXED
#error "control link enabled but this board has no control port (zlrs-control-uart/-cdc)"
#endif

#if IS_ENABLED(CONFIG_ZLRS_APP_LINK_DATA) && !ZLRS_PORT_DATA_FIXED
#error "data link enabled but this board has no data port (zlrs-data-uart/-cdc)"
#endif

#if IS_ENABLED(CONFIG_ZLRS_APP_WATCHDOG) && !ZLRS_HAS_WDT
#error "watchdog enabled but this board has no watchdog device"
#endif
```

## src/config_port.c
```c
/*
 * 配置模式的落地：数据 UART 收配置帧 → 分发 → 回响应。
 *
 * 配置模式期间不跑超帧、不做透传：按键时机把两种用途分开（doc/02 第 10 节）。
 *
 * SPDX-License-Identifier: Apache-2.0
 */

#include "config_port.h"

#include <zephyr/device.h>
#include <zephyr/devicetree.h>
#include <zephyr/drivers/uart.h>
#include <zephyr/kernel.h>
#include <zephyr/logging/log.h>

#include <string.h>

#include "board.h"
#include "led_port.h"
#include "store.h"
#include "zlrs/config/config.h"
#include "zlrs/link/link.h"

LOG_MODULE_REGISTER(zlrs_config_port, CONFIG_APP_LOG_LEVEL);

#define RX_CHUNK 32U
#define EXIT_POLL_MS 50U

static const struct device *const uart = DEVICE_DT_GET(DT_ALIAS(zlrs_data_uart));

static zlrs_cfg_parser_t parser;
static uint8_t tx_line[ZLRS_CFG_FRAME_MAX_LEN];
static zlrs_link_t *link; /* 配置模式作用的链路（控制链路） */
static uint8_t *failsafe_out;

/* ---- backend：把命令落到 NVS 与链路层 ------------------------------------ */

static int cfg_save_root_key(void *ctx, const uint8_t key[ZLRS_KEY_LEN])
{
	(void)ctx;

	if (zlrs_store_save_root_key(key) != 0) {
		return ZLRS_CFG_E_STORE;
	}

	/* 立刻生效，不必等重启 */
	zlrs_link_set_root_key(link, key, k_uptime_get_32());

	LOG_INF("root key written");

	return ZLRS_CFG_OK;
}

static int cfg_read_status(void *ctx, zlrs_cfg_status_t *out)
{
	(void)ctx;

	out->version = ZLRS_CFG_VERSION;
	out->role = link->cfg.role;
	out->state = link->state;
	out->flags = 0U;
	if (link->configured) {
		out->flags |= ZLRS_CFG_FLAG_KEY;
	}
	if (link->paired) {
		out->flags |= ZLRS_CFG_FLAG_PAIRED;
		memcpy(out->peer_id, link->peer_id, ZLRS_DEV_ID_LEN);
	}
	if (link->session_valid) {
		out->flags |= ZLRS_CFG_FLAG_SESSION;
	}
	memcpy(out->dev_id, link->dev_id, ZLRS_DEV_ID_LEN);
	out->lq_percent = link->stats.lq_percent;
	out->band = ZLRS_SUBG_BAND;

	return ZLRS_CFG_OK;
}

static int cfg_save_failsafe(void *ctx, const uint8_t channels[ZLRS_CFG_FAILSAFE_LEN])
{
	(void)ctx;

	if (zlrs_store_save_failsafe(channels) != 0) {
		return ZLRS_CFG_E_STORE;
	}
	if (failsafe_out != NULL) {
		memcpy(failsafe_out, channels, ZLRS_CFG_FAILSAFE_LEN);
	}
	/* 下次配对时把新值下发给对端 */
	zlrs_link_set_failsafe(link, channels, ZLRS_CFG_FAILSAFE_LEN);

	LOG_INF("failsafe values written");

	return ZLRS_CFG_OK;
}

static int cfg_save_baud(void *ctx, uint32_t baud)
{
	(void)ctx;

	if (baud < 9600U || baud > 4000000U) {
		return ZLRS_CFG_E_PARAM;
	}
	if (zlrs_store_save_baud(baud) != 0) {
		return ZLRS_CFG_E_STORE;
	}

	LOG_INF("data port baud set to %u (takes effect on next boot)", (unsigned int)baud);

	return ZLRS_CFG_OK;
}

static int cfg_pair(void *ctx)
{
	(void)ctx;

	zlrs_link_press(link, k_uptime_get_32());
	LOG_INF("pairing triggered by config tool");

	return ZLRS_CFG_OK;
}

static const zlrs_cfg_backend_t backend = {
	.save_root_key = cfg_save_root_key,
	.read_status = cfg_read_status,
	.save_failsafe = cfg_save_failsafe,
	.save_baud = cfg_save_baud,
	.pair = cfg_pair,
};

/* ---- 会话 ---------------------------------------------------------------- */

int zlrs_config_mode_run(zlrs_link_t *control, uint8_t *failsafe)
{
	const uint32_t timeout_ms =
		(uint32_t)CONFIG_ZLRS_APP_CONFIG_TIMEOUT_S * 1000U;
	uint32_t last_activity_ms = k_uptime_get_32();
	bool exit_requested = false;

	link = control;
	failsafe_out = failsafe;

	if (!device_is_ready(uart)) {
		LOG_ERR("data port unavailable, cannot enter config mode");
		return -1;
	}

	/* 配置模式直接用轮询收发：这里没有超帧要抢时间，逻辑越直白越好 */
	zlrs_cfg_parser_init(&parser);

	LOG_INF("config mode: %u s idle timeout, exit on EXIT command",
		(unsigned int)CONFIG_ZLRS_APP_CONFIG_TIMEOUT_S);

	while (!exit_requested &&
	       (uint32_t)(k_uptime_get_32() - last_activity_ms) < timeout_ms) {
		uint8_t chunk[RX_CHUNK];
		bool any = false;
		zlrs_led_input_t led_in;

		/* 配置模式：白灯慢闪，一眼看出"现在不是正常工作状态" */
		memset(&led_in, 0, sizeof(led_in));
		led_in.config_mode = true;
		led_in.configured = link->configured;
		led_in.paired = link->paired;
		led_in.role_tx = IS_ENABLED(CONFIG_ZLRS_APP_ROLE_TX);
		led_in.link_state = link->state;
		led_in.lq_percent = link->stats.lq_percent;
		led_in.uptime_ms = k_uptime_get_32();
		zlrs_led_port_update(&led_in, led_in.uptime_ms);

		for (size_t i = 0U; i < sizeof(chunk); i++) {
			if (uart_poll_in(uart, &chunk[i]) != 0) {
				break;
			}
			any = true;

			const int result = zlrs_cfg_feed(&parser, chunk[i]);

			if (result != 1) {
				continue;
			}

			last_activity_ms = k_uptime_get_32();

			if (parser.cmd == ZLRS_CFG_CMD_EXIT) {
				exit_requested = true;
			}

			const uint8_t len = zlrs_cfg_dispatch(&backend, parser.cmd,
							      ZLRS_CFG_PAYLOAD(&parser),
							      parser.payload_len, tx_line,
							      sizeof(tx_line));

			for (uint8_t b = 0U; b < len; b++) {
				uart_poll_out(uart, tx_line[b]);
			}
		}

		if (!any) {
			k_msleep(EXIT_POLL_MS);
		}
	}

	LOG_INF("config mode finished");

	return exit_requested ? 0 : 1;
}
```

## src/config_port.h
```c
/*
 * 配置模式：开机时按住按键进入，数据口改跑配置协议（见 doc/01-system.md 2.1）。
 *
 * SPDX-License-Identifier: Apache-2.0
 */

#ifndef ZLRS_APP_CONFIG_PORT_H_
#define ZLRS_APP_CONFIG_PORT_H_

#include <stdint.h>

#include "zlrs/link/link.h"

/*
 * 阻塞式跑配置会话：到超时或收到 EXIT 为止。
 * 命令作用在 control 链路上；失控值写进 failsafe（应用自己那份缓冲）。
 * 返回 0 = 收到 EXIT，1 = 超时。
 */
int zlrs_config_mode_run(zlrs_link_t *control, uint8_t *failsafe);

#endif /* ZLRS_APP_CONFIG_PORT_H_ */
```

## src/crsf_port.c
```c
/*
 * CRSF 端口的 Zephyr 侧实现：中断收字节 → 解析器 → 帧环形缓冲，主循环取走。
 *
 * SPDX-License-Identifier: Apache-2.0
 */

#include "crsf_port.h"

#include <zephyr/device.h>
#include <zephyr/devicetree.h>
#include <zephyr/drivers/uart.h>
#include <zephyr/logging/log.h>
#include <zephyr/sys/ring_buffer.h>

#include <string.h>

#include "zlrs/crsf/crsf.h"

LOG_MODULE_REGISTER(zlrs_crsf_port, CONFIG_APP_LOG_LEVEL);

/* 帧缓冲按"1 字节长度 + 1 字节类型 + 载荷"存放 */
#define FRAME_SLOT_LEN (2U + ZLRS_CRSF_PAYLOAD_MAX_LEN)
#define FRAME_RING_LEN 512U
#define TX_RING_LEN 1024U

#if DT_NODE_EXISTS(DT_ALIAS(zlrs_crsf_uart))
static const struct device *const uart = DEVICE_DT_GET(DT_ALIAS(zlrs_crsf_uart));
#define CRSF_PORT_AVAILABLE 1
#else
#define CRSF_PORT_AVAILABLE 0
#endif

static uint8_t frame_ring_mem[FRAME_RING_LEN];
static uint8_t tx_ring_mem[TX_RING_LEN];
static struct ring_buf frame_ring;
static struct ring_buf tx_ring;
static zlrs_crsf_parser_t parser;
static uint32_t rx_dropped;
static bool ready;

static void uart_isr(const struct device *dev, void *user_data)
{
	(void)user_data;

	while (uart_irq_update(dev) && uart_irq_is_pending(dev)) {
		if (uart_irq_rx_ready(dev)) {
			uint8_t chunk[32];
			const int n = uart_fifo_read(dev, chunk, sizeof(chunk));

			for (int i = 0; i < n; i++) {
				uint8_t record[FRAME_SLOT_LEN];
				const enum zlrs_crsf_result result =
					zlrs_crsf_feed(&parser, chunk[i]);

				if (result != ZLRS_CRSF_FRAME) {
					continue;
				}

				record[0] = parser.payload_len;
				record[1] = parser.type;
				memcpy(&record[2], ZLRS_CRSF_PAYLOAD(&parser),
				       parser.payload_len);

				if (ring_buf_put(&frame_ring, record,
						 (uint32_t)parser.payload_len + 2U) !=
				    (uint32_t)parser.payload_len + 2U) {
					rx_dropped++;
				}
			}
		}

		if (uart_irq_tx_ready(dev)) {
			uint8_t *claim = NULL;
			const uint32_t claimed = ring_buf_get_claim(&tx_ring, &claim, 64U);

			if (claimed == 0U) {
				uart_irq_tx_disable(dev);
				continue;
			}

			const int sent = uart_fifo_fill(dev, claim, (int)claimed);

			ring_buf_get_finish(&tx_ring, (sent > 0) ? (uint32_t)sent : 0U);
		}
	}
}

int zlrs_crsf_port_init(void)
{
	ring_buf_init(&frame_ring, sizeof(frame_ring_mem), frame_ring_mem);
	ring_buf_init(&tx_ring, sizeof(tx_ring_mem), tx_ring_mem);
	zlrs_crsf_parser_init(&parser);

	if (!CRSF_PORT_AVAILABLE) {
		LOG_WRN("no zlrs-crsf-uart alias on this board: CRSF port disabled");
		return -1;
	}

	if (!device_is_ready(uart)) {
		LOG_ERR("CRSF port not ready (%s)", uart->name);
		return -1;
	}

	uart_irq_callback_user_data_set(uart, uart_isr, NULL);
	uart_irq_rx_enable(uart);
	ready = true;

	LOG_INF("CRSF port ready (%s)", uart->name);

	return 0;
}

bool zlrs_crsf_port_ready(void)
{
	return ready;
}

uint8_t zlrs_crsf_port_write(uint8_t type, const uint8_t *payload, uint8_t payload_len)
{
	uint8_t frame[ZLRS_CRSF_FRAME_MAX_LEN];
	const uint8_t addr = (type == ZLRS_CRSF_TYPE_RC_CHANNELS)
				     ? ZLRS_CRSF_ADDR_FC
				     : ZLRS_CRSF_ADDR_TX_MODULE;
	const uint8_t len = zlrs_crsf_encode(frame, addr, type, payload, payload_len);

	if (!ready || len == 0U) {
		return 0U;
	}

	if (ring_buf_put(&tx_ring, frame, len) != len) {
		return 0U; /* 发送缓冲满：CRSF 是尽力而为，丢帧并计数交给调用方 */
	}

	uart_irq_tx_enable(uart);

	return len;
}

uint8_t zlrs_crsf_port_read(uint8_t *type, uint8_t *payload, uint8_t max_len)
{
	uint8_t header[2];
	uint8_t len;

	if (ring_buf_size_get(&frame_ring) < 2U) {
		return 0U;
	}

	if (ring_buf_peek(&frame_ring, header, sizeof(header)) != sizeof(header)) {
		return 0U;
	}
	if (header[0] > max_len) {
		/* 载荷缓冲区太小：整帧丢弃，避免缓冲错位 */
		uint8_t scratch[FRAME_SLOT_LEN];

		(void)ring_buf_get(&frame_ring, scratch, (uint32_t)header[0] + 2U);
		return 0U;
	}
	if (ring_buf_size_get(&frame_ring) < (uint32_t)header[0] + 2U) {
		return 0U;
	}

	(void)ring_buf_get(&frame_ring, header, sizeof(header));
	len = header[0];
	*type = header[1];
	(void)ring_buf_get(&frame_ring, payload, len);

	return len;
}

uint32_t zlrs_crsf_port_rx_dropped(void)
{
	return rx_dropped;
}
```

## src/diagnostics.h
```c
/* SPDX-License-Identifier: Apache-2.0 */
#pragma once
/* Diagnostic IDs belong to the application; management converts their wire representation. */
typedef enum {
	ZLRS_DIAGNOSTIC_LINK = 0,
	ZLRS_DIAGNOSTIC_RATE,
	ZLRS_DIAGNOSTIC_RADIO,
	ZLRS_DIAGNOSTIC_POWER,
} zlrs_diagnostic_report_t;

/* Snapshot and render on the owner thread; native SMP carries the complete text. */
int zlrs_diagnostics_report(zlrs_diagnostic_report_t report, const char **text);
```
