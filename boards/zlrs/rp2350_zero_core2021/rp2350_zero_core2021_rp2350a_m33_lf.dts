/*
 * Copyright (c) 2026 zlrs contributors
 *
 * SPDX-License-Identifier: Apache-2.0
 *
 * LF variant (470 / 433). Same composition as hf with step 4 swapped for the LF SKU's sub-G
 * calibration.
 */

/dts-v1/;

#include <raspberrypi/rpi_pico/rp2350a.dtsi>
#include <raspberrypi/rpi_pico/m33.dtsi>

#include "rp2350_zero_core2021.dtsi"
#include "rp2350_zero_core2021_lf.dtsi"
#include "rp2350_zero_core2021_partitions.dtsi"

/* The boot-mode area the application uses to enter serial recovery (same as hf/mcuboot) */
#include <vendor/raspberrypi/rp2350-boot-mode-retention.dtsi>

/ {
	chosen {
		zephyr,code-partition = &slot0_partition;
		/* Serial recovery is USB only (the data port CDC), same as hf/mcuboot */
		zephyr,uart-mcumgr = &cdc_acm_uart1;
	};
};
