/*
 * Copyright (c) 2026 zlrs contributors
 *
 * SPDX-License-Identifier: Apache-2.0
 */

/dts-v1/;

/*
 * 不带变体的目标：按 HF 构建，等价于 `.../rp2350a/m33/hf`。
 * 两个 SKU 请显式指定变体（hf / lf），这个文件只是方便手滑与旧脚本。
 */
#include <raspberrypi/rpi_pico/rp2350a.dtsi>
#include <raspberrypi/rpi_pico/m33.dtsi>

#include "rp2350_zero_core2021.dtsi"
#include "rp2350_zero_core2021_hf.dtsi"
