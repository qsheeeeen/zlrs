/*
 * Copyright (c) 2026 zlrs contributors
 *
 * SPDX-License-Identifier: Apache-2.0
 */

/dts-v1/;

/* The build system wants a board dts named after the cpucluster; it composes, in order:
 * 1. SoC common part (rp2350a)  2. core part (Cortex-M33)
 * 3. board common part        4. HF SKU sub-G calibration (868 / 915)
 * 5. partition table (no bootloader: 1 MB code + 3 MB storage)
 */
#include <raspberrypi/rpi_pico/rp2350a.dtsi>
#include <raspberrypi/rpi_pico/m33.dtsi>

#include "rp2350_zero_core2021.dtsi"
#include "rp2350_zero_core2021_hf.dtsi"
#include "rp2350_zero_core2021_partitions_1m.dtsi"
