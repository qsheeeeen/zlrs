/*
 * Copyright (c) 2026 zlrs contributors
 *
 * SPDX-License-Identifier: Apache-2.0
 *
 * HF variant with MCUboot (868 / 915). Composition order:
 * 1. SoC common part (rp2350a)  2. core part (Cortex-M33)
 * 3. board common part        4. HF SKU sub-G calibration
 * 5. MCUboot partition table (see the README and partitions_mcuboot.dtsi)
 */

/dts-v1/;

#include <raspberrypi/rpi_pico/rp2350a.dtsi>
#include <raspberrypi/rpi_pico/m33.dtsi>

#include "rp2350_zero_core2021.dtsi"
#include "rp2350_zero_core2021_hf.dtsi"

/* Partitions: mcuboot 128 KB / slot0 832 KB / slot1 832 KB / storage 2.25 MB */
#include "rp2350_zero_core2021_partitions_mcuboot.dtsi"

/* The boot-mode area the application uses to enter serial recovery: the RP2350 overlay in the
  * Zephyr tree keeps 4 bytes at the start of SRAM and moves sram0 aside (doc/08-firmware.md 6). */
#include <vendor/raspberrypi/rp2350-boot-mode-retention.dtsi>

/ {
	chosen {
		/* The application links into slot0: MCUboot boots it from there once the signature checks out */
		zephyr,code-partition = &slot0_partition;
		/*
		 * MCUboot serial recovery is USB only: it points at the data port CDC (`cdc_acm_uart1`, the
		 * second port the on-board USB-C enumerates). One USB cable is enough to upgrade, no UART
		 * adapter needed, and the GP8/GP9 UART stays with the application. */
		 */
		zephyr,uart-mcumgr = &cdc_acm_uart1;
	};
};
