## dts/bindings/zlrs,radio.yaml
```yaml
# Copyright (c) 2026 zlrs contributors
# SPDX-License-Identifier: Apache-2.0

description: |
  Board radio configuration. regions lists
  exactly the predefined channel plans selectable at runtime. Calibration and
  power bounds describe the physical radio independently of regional rules.

compatible: "zlrs,radio"

properties:
  regions:
    type: array
    required: true
    description: |
      Nonempty set of channel-plan IDs from zephyr/dt-bindings/zlrs/region.h.
      A board may declare any subset, including all predefined regions.

  default-region:
    type: int
    required: true
    description: |
      Region used until NVS holds one (0 = FCC915, 1 = EU868, 2 = CN470, 3 =
      CN433). It must belong to regions. This is only the initial
      selection; runtime settings remain restricted to the declared set.
    enum: [0, 1, 2, 3]

  ism2400-min-tx-power-dbm:
    type: int
    required: true
    description: Minimum calibrated 2.4 GHz transmit setpoint

  ism2400-max-tx-power-dbm:
    type: int
    required: true
    description: Maximum allowed 2.4 GHz transmit setpoint for this board

  subg-min-tx-power-dbm:
    type: int
    required: true
    description: Minimum calibrated SubG transmit setpoint

  subg-max-tx-power-dbm:
    type: int
    required: true
    description: Maximum allowed SubG transmit setpoint before regional policy
```

## dts/bindings/zlrs,rf-design.yaml
```yaml
# Copyright (c) 2026 zlrs contributors
# SPDX-License-Identifier: Apache-2.0

description: |
  The radio design: which sub-G hardware this board carries and the frequency
  range it can actually reach. A region is accepted when its band and band
  edges fit inside this design (see zlrs_region_validate() in core/region), so
  the software validates hardware capability instead of a board name.

  The node is declared once per board variant (HF or LF SKU) and also carries
  the calibration data for that PA network.

compatible: "zlrs,rf-design"

properties:
  band:
    type: int
    required: true
    description: 0 = LF (410-510 MHz), 1 = HF (850-930 MHz)
    enum: [0, 1]

  low-hz:
    type: int
    required: true
    description: Lowest frequency this radio design is built for

  high-hz:
    type: int
    required: true
    description: Highest frequency this radio design is built for
```

## dts/bindings/zlrs,subg-band.yaml
```yaml
# Copyright (c) 2026 zlrs contributors
# SPDX-License-Identifier: Apache-2.0

description: |
  Local sub-G hardware (the Core2021 SKU): 0 = LF (470/433), 1 = HF (868/915).
  The region has to match it (an LF board cannot do 915), see zlrs_region_validate() in lib/region.

compatible: "zlrs,subg-band"

properties:
  band:
    type: int
    required: true
    description: 0 = LF (470 / 433), 1 = HF (868 / 915)
    enum: [0, 1]
```

## lib/Kconfig
```kconfig
# Copyright (c) 2026 zlrs contributors
# SPDX-License-Identifier: Apache-2.0

menu "zlrs libraries"

rsource "proto/Kconfig"
rsource "link/Kconfig"
rsource "crsf/Kconfig"
rsource "config/Kconfig"
rsource "region/Kconfig"
rsource "led/Kconfig"
rsource "usb/Kconfig"
rsource "bootguard/Kconfig"

endmenu
```

## lib/config/Kconfig
```kconfig
# Copyright (c) 2026 zlrs contributors
# SPDX-License-Identifier: Apache-2.0

config ZLRS_CONFIG
	bool "Config protocol (framing and dispatch on the config CDC)"
	select ZLRS_PROTO
	help
	  Framing and command dispatch for the config CDC while the device is in config mode
	  (entries: docs/design/08-firmware.md 2, command table: docs/design/10-security.md 10).
	  Pure C: commands only touch the device through backend callbacks, so the host tests
	  can run every one of them against a fake backend, see tests/host.

module = ZLRS_CONFIG
module-str = zlrs_config
source "subsys/logging/Kconfig.template.log_config"
```

## lib/crsf/Kconfig
```kconfig
# Copyright (c) 2026 zlrs contributors
# SPDX-License-Identifier: Apache-2.0

config ZLRS_CRSF
	bool "CRSF codec (channel packing, link statistics frame)"
	help
	  CRSF framing for the two ground-side ports (handset <-> module, receiver -> flight
	  controller): 16-channel packing and the link statistics frame. Pure C, see tests/host.

module = ZLRS_CRSF
module-str = zlrs_crsf
source "subsys/logging/Kconfig.template.log_config"
```

## lib/led/Kconfig
```kconfig
# Copyright (c) 2026 zlrs contributors
# SPDX-License-Identifier: Apache-2.0

config ZLRS_LED
	bool "状态灯灯语（状态 → 颜色与节奏）"
	select ZLRS_LINK
	help
	  把链路状态与告警映射到单个像素的颜色与节奏（灯语表见 doc/11-ux.md）。
	  纯 C，见 tests/host；灯带驱动在应用侧（app/src/led_port.c）。

module = ZLRS_LED
module-str = zlrs_led
source "subsys/logging/Kconfig.template.log_config"
```

## lib/link/Kconfig
```kconfig
# Copyright (c) 2026 zlrs contributors
# SPDX-License-Identifier: Apache-2.0

config ZLRS_LINK
	bool "Link layer (state machine, pairing and sessions, superframe slots)"
	select ZLRS_PROTO
	help
	  Link state machine, pairing and session handling, superframe slots, and the radio
	  abstraction the application implements on top of USP/RAC. Pure C, see tests/host.

module = ZLRS_LINK
module-str = zlrs_link
source "subsys/logging/Kconfig.template.log_config"
```

## lib/proto/Kconfig
```kconfig
# Copyright (c) 2026 zlrs contributors
# SPDX-License-Identifier: Apache-2.0

config ZLRS_PROTO
	bool "协议核心（帧编解码 / 跳频序列 / 分片重组 / CRC）"
	select PSA_CRYPTO
	select PSA_WANT_ALG_HKDF
	select PSA_WANT_ALG_HMAC
	select PSA_WANT_ALG_SHA_256
	select PSA_WANT_KEY_TYPE_DERIVE
	select PSA_WANT_KEY_TYPE_HMAC
	help
	  纯 C，不依赖 Zephyr。密码学那部分依赖具体实现：目标上是 Zephyr 的
	  PSA Crypto（lib/proto/crypto_psa.c，所以上面 select 了那几个算法），
	  主机侧测试改用一份自带的软件实现（tests/host/crypto_soft.c），
	  两边出的字节必须一致。

module = ZLRS_PROTO
module-str = zlrs_proto
source "subsys/logging/Kconfig.template.log_config"
```

## lib/region/Kconfig
```kconfig
# Copyright (c) 2026 zlrs contributors
# SPDX-License-Identifier: Apache-2.0

config ZLRS_REGION
	bool "Region tables (channel plan, power ceiling, duty cycle)"
	select ZLRS_PROTO
	help
	  Per-region channel plans, power ceilings, duty caps and the duty accounting every TX goes through.
	  Pure C, see tests/host.

module = ZLRS_REGION
module-str = zlrs_region
source "subsys/logging/Kconfig.template.log_config"
```

## lib/usb/Kconfig
```kconfig
# Copyright (c) 2026 zlrs contributors
# SPDX-License-Identifier: Apache-2.0

menu "zlrs usb device"

config ZLRS_USB
	bool "USB device stack (own usbd context, every CDC in devicetree)"
	depends on USB_DEVICE_STACK_NEXT && USBD_CDC_ACM_CLASS
	help
	  Shared by the application and the MCUboot image; only the strings and VID/PID below differ.

	  In the device_next stack a `zephyr,cdc-acm-uart` node only says how many CDCs exist; the
	  image has to build a context, register the classes and call usbd_enable() itself.
	  Zephyr's CONFIG_CDC_ACM_SERIAL_INITIALIZE_AT_BOOT registers only the first CDC; the rest
	  have no context and NULL-dereference on the first log write. This code registers them all.

if ZLRS_USB

config ZLRS_USB_VID
	hex "USB vendor ID (VID)"
	default 0x2fe3
	help
	  0x2fe3 is the VID Zephyr reserves for its own samples. A product needs its own.

config ZLRS_USB_PID
	hex "USB product ID (PID)"
	default 0x0004

config ZLRS_USB_MANUFACTURER
	string "USB manufacturer string"
	default "zlrs"

config ZLRS_USB_PRODUCT
	string "USB product string"
	default "ZLRS"
	help
	  The update tool finds its ports by name in /dev/serial/by-id: the application is "ZLRS",
	  the bootloader is "ZLRS MCUBOOT" (see scripts/zlrs-update.py).

config ZLRS_USB_MAX_POWER
	int "USB bMaxPower (units of 2 mA)"
	default 125
	range 0 250

endif # ZLRS_USB

endmenu

module = ZLRS_USB
module-str = zlrs_usb
source "subsys/logging/Kconfig.template.log_config"
```

## tests/app/link/bench/testcase.yaml
```yaml
# SPDX-License-Identifier: Apache-2.0
common:
  harness: ztest
  tags: [benchmark, protocol]
  platform_allow: [native_sim/native/64]
  timeout: 120
tests:
  zlrs.bench.link: {}
```

## tests/app/log/testcase.yaml
```yaml
# SPDX-License-Identifier: Apache-2.0
common:
  harness: ztest
  tags: [log, storage]
  platform_allow: [native_sim/native/64]
tests:
  zlrs.log.storage: {}
```

## tests/app/mgmt/testcase.yaml
```yaml
# SPDX-License-Identifier: Apache-2.0
common:
  harness: ztest
  tags: [mgmt, persist]
  platform_allow: [native_sim/native/64]
tests:
  zlrs.mgmt.commands: {}
  zlrs.mgmt.commands.release:
    extra_configs:
      - CONFIG_ZLRS_APP_DEBUG=n
```

## tests/app/trace/testcase.yaml
```yaml
# SPDX-License-Identifier: Apache-2.0
common:
  harness: ztest
  tags: [trace]
  platform_allow: [native_sim/native/64]
tests:
  zlrs.trace.rolling: {}
  zlrs.trace.rolling_non_power_of_two:
    extra_configs:
      - CONFIG_RAM_TRACING_BUFFER_SIZE=1000
```

## tests/app/ui/testcase.yaml
```yaml
# SPDX-License-Identifier: Apache-2.0
common:
  harness: ztest
  tags: [ui, zbus]
  platform_allow: [native_sim/native/64]
  timeout: 120
tests:
  zlrs.ui.state: {}
  zlrs.ui.debug:
    extra_configs:
      - CONFIG_ZLRS_APP_DEBUG=y
      - CONFIG_ZLRS_APP_DEBUG_LED_BRIGHTNESS_PERCENT=1
```

## tests/bench/Kconfig
```kconfig
# SPDX-License-Identifier: Apache-2.0
source "Kconfig.zephyr"
config ZLRS_BENCH_ITERATIONS
	int "Iterations per benchmark sample"
	default 20000
	range 100 1000000
```

## tests/hardware/latency/Kconfig
```kconfig
# SPDX-License-Identifier: Apache-2.0
rsource "../../../app/Kconfig"
config ZLRS_APP_DEBUG_TRACE_ROLLING
 bool
 default y
```

## tests/hardware/radio/Kconfig
```kconfig
# SPDX-License-Identifier: Apache-2.0
rsource "../../../app/Kconfig"

config ZLRS_TEST_RAW_MS
	int "Raw radio test duration after host start (ms, 0 disables raw mode)"
	default 0
	range 0 60000

config ZLRS_TEST_RAW_FREQ_MHZ
	int "Fixed frequency for raw 2.4 GHz tests (MHz)"
	default 2441
	range 2402 2480
```

## tests/hardware/serial/testcase.yaml
```yaml
# SPDX-License-Identifier: Apache-2.0
common:
  sysbuild: true
  harness: ztest
  tags: [serial, hardware]
  timeout: 60
  platform_allow:
    - rp2350_zero_core2021/rp2350a/m33/lf
    - rp2350_zero_core2021/rp2350a/m33/hf
  extra_args:
    - SB_APPLICATION_CONFIG_DIR=${ZEPHYR_ZLRS_MODULE_DIR}/app
tests:
  zlrs.serial.rp2350: {}
```
