## CMakeLists.txt
```
# SPDX-License-Identifier: Apache-2.0

cmake_minimum_required(VERSION 3.20.0)
find_package(Zephyr REQUIRED HINTS $ENV{ZEPHYR_BASE})
project(unit)

get_filename_component(zlrs_root "${CMAKE_CURRENT_SOURCE_DIR}/../../.." ABSOLUTE)
include("${zlrs_root}/app/src/CMakeLists.txt")
zephyr_get(ZLRS_TEST_ENTROPY_ONLY)
option(ZLRS_TEST_ENTROPY_ONLY "Run only hardware entropy acceptance without storage tests" OFF)
set(ZLRS_TEST_ENTROPY_ONLY "${ZLRS_TEST_ENTROPY_ONLY}" CACHE BOOL
  "Run only hardware entropy acceptance without storage tests" FORCE)
zephyr_get(ZLRS_TEST_UI_ONLY)
option(ZLRS_TEST_UI_ONLY "Run only LED acceptance without storage tests" OFF)
set(ZLRS_TEST_UI_ONLY "${ZLRS_TEST_UI_ONLY}" CACHE BOOL
  "Run only LED acceptance without storage tests" FORCE)
if(ZLRS_TEST_ENTROPY_ONLY AND ZLRS_TEST_UI_ONLY)
  message(FATAL_ERROR "Select only one isolated hardware fixture")
endif()
target_sources(app PRIVATE
  ../ztest_main.c
  "${zlrs_root}/app/src/platform/sha256.c"
)
target_include_directories(app PRIVATE
  "${zlrs_root}/app/src"
  ..
)

if(ZLRS_TEST_UI_ONLY)
  target_sources(app PRIVATE
    "${zlrs_root}/tests/contracts/test_led.c"
    "${zlrs_root}/app/src/ui.c"
  )
else()
  target_sources(app PRIVATE
    ../drivers/entropy/test_rp2350_trng.c
  )
endif()

if(NOT ZLRS_TEST_ENTROPY_ONLY AND NOT ZLRS_TEST_UI_ONLY)
  target_sources(app PRIVATE
    ../drivers/crypto/test_rp2350_sha256.c
    ../protocol/proto/test_crypto.c
    ../app/storage/test_log.c
    "${zlrs_root}/tests/contracts/test_persist.c"
    ../protocol/link/test_link.c
    ../app/link/test_power.c
    ../app/platform/test_slot_timer.c
    "${zlrs_root}/tests/contracts/test_led.c"
    "${zlrs_root}/app/src/persist.c"
    "${zlrs_root}/app/src/power.c"
    "${zlrs_root}/app/src/platform/slot_timer.c"
    "${zlrs_root}/app/src/ui.c"
    "${zlrs_root}/app/src/log.c"
  )
  target_link_options(app PUBLIC "-Wl,--wrap=settings_save_one" "-Wl,--wrap=nvs_clear"
    "-Wl,--wrap=settings_load_subtree")
endif()

# Match production placement of the protocol algorithms, SHA operation and driver.
zephyr_code_relocate(
  FILES
  "${zlrs_root}/app/src/platform/sha256.c"
  "${zlrs_root}/app/src/proto/crypto.c"
  "${zlrs_root}/drivers/crypto/rp2350_sha256.c"
  LOCATION RAM_TEXT
)
```

## Kconfig
```
# SPDX-License-Identifier: Apache-2.0

rsource "../../../app/Kconfig"
```

## sysbuild.conf
```
../../../app/sysbuild.conf
```

## prj.conf
```kconfig
# SPDX-License-Identifier: Apache-2.0

CONFIG_ZTEST=y
CONFIG_IRQ_OFFLOAD=y
CONFIG_TEST_HW_STACK_PROTECTION=n
CONFIG_TEST_LOGGING_DEFAULTS=n
CONFIG_ZTEST_STACK_SIZE=3072
CONFIG_ZTEST_NO_YIELD=n
CONFIG_MAIN_STACK_SIZE=4096
CONFIG_BOOT_BANNER=n
CONFIG_HEAP_MEM_POOL_SIZE=4096
CONFIG_PM_DEVICE=y
CONFIG_LED_STRIP=y
CONFIG_INPUT=y
CONFIG_ZBUS=y
CONFIG_ASSERT=y
CONFIG_SPEED_OPTIMIZATIONS=y
# RP2350 USB DPRAM faults on the toolchain memcpy halfword stores.
CONFIG_MINIMAL_LIBC=y
CONFIG_MINIMAL_LIBC_OPTIMIZE_STRING_FOR_SIZE=y
CONFIG_MINIMAL_LIBC_LL_PRINTF=y
CONFIG_SYS_CLOCK_TICKS_PER_SEC=1000
CONFIG_ZERO_LATENCY_IRQS=y
CONFIG_CODE_DATA_RELOCATION=y
CONFIG_CRYPTO=y
CONFIG_ENTROPY_GENERATOR=y
CONFIG_ENTROPY_INIT_PRIORITY=60
CONFIG_CSPRNG_NEEDED=y
CONFIG_LOG=y
CONFIG_LOG_MODE_DEFERRED=y
CONFIG_LOG_PROCESS_THREAD=n
CONFIG_LOG_BACKEND_UART=y
CONFIG_LOG_PRINTK=n
CONFIG_CONSOLE=y
CONFIG_UART_CONSOLE=y
CONFIG_REBOOT=y
CONFIG_WATCHDOG=y

# Settings fixture backs up and restores the complete NVS partition.
CONFIG_FLASH=y
CONFIG_FLASH_MAP=y
CONFIG_NVS=y
CONFIG_SETTINGS=y
CONFIG_SETTINGS_NVS=y
CONFIG_IMG_MANAGER=y
CONFIG_STREAM_FLASH=y

CONFIG_ZLRS_USB=y
CONFIG_ZLRS_USB_PRODUCT="ZLRS UNIT TEST"
CONFIG_HWINFO=y
CONFIG_CDC_ACM_SERIAL_INITIALIZE_AT_BOOT=n
CONFIG_USBD_CDC_ACM_LOG_LEVEL_OFF=y
CONFIG_UDC_RPI_PICO_STACK_SIZE=2048
CONFIG_USBD_THREAD_STACK_SIZE=2048

# Production log storage settings; the test only reads the existing log inventory.
CONFIG_ZLRS_APP_DYNAMIC_POWER=y
CONFIG_FILE_SYSTEM=y
CONFIG_FILE_SYSTEM_LITTLEFS=y
CONFIG_FILE_SYSTEM_MKFS=y
CONFIG_FLASH_PAGE_LAYOUT=y
CONFIG_LOG_BACKEND_FS=y
CONFIG_LOG_BACKEND_FS_DIR="/lfs"
CONFIG_LOG_BACKEND_FS_FILE_PREFIX="log."
CONFIG_LOG_BACKEND_FS_FILE_SIZE=131072
CONFIG_LOG_BACKEND_FS_FILES_LIMIT=8
CONFIG_LOG_BACKEND_FS_OVERWRITE=y
CONFIG_LOG_BACKEND_FS_APPEND_TO_NEWEST_FILE=y
CONFIG_LOG_CORE_INIT_PRIORITY=90
```

## app.overlay
```dts
/* SPDX-License-Identifier: Apache-2.0 */

/ {
	aliases {
		zlrs-led = &led_test;
	};
	led_test: led-test {};
};

&cdc_acm_uart2 {
	status = "okay";
	tx-fifo-size = <8192>;
};
```

## src/main.c
```c
/* SPDX-License-Identifier: Apache-2.0 */

#include <zephyr/device.h>
#include <zephyr/drivers/uart.h>
#include <zephyr/drivers/watchdog.h>
#include <zephyr/init.h>
#include <zephyr/kernel.h>
#include <zephyr/sys/reboot.h>
#include <zephyr/ztest.h>

static const struct device *const watchdog = DEVICE_DT_GET(DT_ALIAS(watchdog0));
static int watchdog_channel;

static void feed_watchdog(struct k_timer *timer)
{
	ARG_UNUSED(timer);
	(void)wdt_feed(watchdog, watchdog_channel);
}

K_TIMER_DEFINE(watchdog_timer, feed_watchdog, NULL);

static int arm_watchdog(void)
{
	const struct wdt_timeout_cfg timeout = {
		.window.max = 8000U,
		.flags = WDT_FLAG_RESET_SOC,
	};

	/* Arm before console/USB initialization so an early fault also causes rollback. */
	watchdog_channel = wdt_install_timeout(watchdog, &timeout);
	if (watchdog_channel < 0) {
		return watchdog_channel;
	}
	return wdt_setup(watchdog, 0U);
}

SYS_INIT(arm_watchdog, PRE_KERNEL_1, 51);

static void restore_firmware(struct k_work *work)
{
	ARG_UNUSED(work);
	/* Leave this image unconfirmed: MCUboot restores the previously confirmed firmware. */
	sys_reboot(SYS_REBOOT_COLD);
}

K_WORK_DELAYABLE_DEFINE(restore_work, restore_firmware);

void test_main(void)
{
	const struct device *const console = DEVICE_DT_GET(DT_CHOSEN(zephyr_console));
	uint32_t dtr = 0U;

	k_timer_start(&watchdog_timer, K_SECONDS(1), K_SECONDS(1));
	const int64_t deadline = k_uptime_get() + 45000;

	/* Capture every result after the host opens this test image's console CDC. */
	while (uart_line_ctrl_get(console, UART_LINE_CTRL_DTR, &dtr) != 0 || dtr == 0U) {
		if (k_uptime_get() >= deadline) {
			sys_reboot(SYS_REBOOT_COLD);
		}
		k_msleep(20);
	}
	k_msleep(100);
	ztest_run_all(NULL, false, 1, 1);
	ztest_verify_all_test_suites_ran();
	printk("ZLRS unit tests complete; rebooting for MCUboot rollback in 3 s\n");
	k_work_schedule(&restore_work, K_SECONDS(3));
}
```
