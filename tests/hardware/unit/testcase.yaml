## tests/hardware/unit/testcase.yaml
```yaml
# SPDX-License-Identifier: Apache-2.0

common:
  sysbuild: true
  harness: ztest
  tags:
    - unit
    - hardware
  timeout: 120
  platform_allow:
    - rp2350_zero_core2021/rp2350a/m33/lf
    - rp2350_zero_core2021/rp2350a/m33/hf
  extra_args:
    - SB_APPLICATION_CONFIG_DIR=${ZEPHYR_ZLRS_MODULE_DIR}/app
tests:
  zlrs.unit.rp2350: {}
```

## tests/simulation/application/Kconfig
```kconfig
# SPDX-License-Identifier: Apache-2.0
source "Kconfig.zephyr"
config ZLRS_APP_MCUBOOT_CONFIRM_TIMEOUT_MS
	int
	default 1000
module = APP
module-str = app
source "subsys/logging/Kconfig.template.log_config"
```

## tests/simulation/application/testcase.yaml
```yaml
# SPDX-License-Identifier: Apache-2.0
common:
  tags: [application, boot]
  platform_allow: [native_sim/native/64]
tests:
  zlrs.application.lifecycle: {}
```

## tests/simulation/mgmt/Kconfig
```kconfig
# SPDX-License-Identifier: Apache-2.0
source "Kconfig.zephyr"
config ZLRS_APP_TX_POWER_DBM
 int
 default -10
config ZLRS_APP_MGMT_TIMEOUT_S
 int
 default 10
module = APP
module-str = app
source "subsys/logging/Kconfig.template.log_config"
```

## tests/simulation/mgmt/testcase.yaml
```yaml
# SPDX-License-Identifier: Apache-2.0
common:
  harness: ztest
  tags: [mgmt, persist]
  platform_allow: [native_sim/native/64]
tests:
  zlrs.mgmt.commands: {}
```

## tests/simulation/protocol/Kconfig
```kconfig
# SPDX-License-Identifier: Apache-2.0
source "Kconfig.zephyr"
config ZLRS_TEST_FUZZ_ITERATIONS
	int "Inputs per malformed-frame scenario"
	default 20000
	range 1 1000000
```

## tests/simulation/protocol/testcase.yaml
```yaml
# SPDX-License-Identifier: Apache-2.0
common:
  harness: ztest
  tags: [protocol, link, codec]
  platform_allow: [native_sim/native/64]
  timeout: 120
tests:
  zlrs.protocol: {}
```

## tests/simulation/rf/testcase.yaml
```yaml
# SPDX-License-Identifier: Apache-2.0
common:
  harness: ztest
  tags: [rf, link]
  platform_allow: [native_sim/native/64]
  timeout: 120
tests:
  zlrs.rf.fixed_24_leader: {}
  zlrs.rf.fixed_24_follower:
    extra_args:
      - RF_TEST_ROLE_FOLLOWER=ON
  zlrs.rf.fixed_subg_leader:
    extra_args:
      - RF_TEST_BAND_SUBG=ON
  zlrs.rf.fixed_subg_follower:
    extra_args:
      - RF_TEST_ROLE_FOLLOWER=ON
      - RF_TEST_BAND_SUBG=ON
  zlrs.rf.auto_leader:
    extra_args:
      - RF_TEST_BAND_AUTO=ON
  zlrs.rf.auto_follower:
    extra_args:
      - RF_TEST_BAND_AUTO=ON
      - RF_TEST_ROLE_FOLLOWER=ON
```

## tests/simulation/serial/testcase.yaml
```yaml
# SPDX-License-Identifier: Apache-2.0
common:
  harness: ztest
  tags: [serial, usb]
  platform_allow: [native_sim/native/64]
tests:
  zlrs.serial.selection: {}
  zlrs.serial.usb_only:
    extra_args: DTC_OVERLAY_FILE="app.overlay;usb-only.overlay"
  zlrs.serial.uart_only:
    extra_args: DTC_OVERLAY_FILE="app.overlay;uart-only.overlay"
  zlrs.serial.flow_control:
    extra_args: DTC_OVERLAY_FILE="app.overlay;flow-control.overlay"
  zlrs.serial.uart_only_flow_control:
    extra_args: DTC_OVERLAY_FILE="app.overlay;uart-only.overlay;flow-control.overlay"
```

## tests/simulation/settings/Kconfig
```kconfig
# SPDX-License-Identifier: Apache-2.0
source "Kconfig.zephyr"
module = APP
module-str = app
source "subsys/logging/Kconfig.template.log_config"
```

## tests/simulation/settings/testcase.yaml
```yaml
# SPDX-License-Identifier: Apache-2.0
common:
  tags: [settings, nvs]
  platform_allow: [native_sim/native/64]
tests:
  zlrs.settings.layout: {}
```

## tests/simulation/ui/Kconfig
```kconfig
# SPDX-License-Identifier: Apache-2.0
source "Kconfig.zephyr"
config ZLRS_APP_PAIR_HOLD_MS
 int
 default 1000
module = APP
module-str = app
source "subsys/logging/Kconfig.template.log_config"
```

## tests/simulation/ui/testcase.yaml
```yaml
# SPDX-License-Identifier: Apache-2.0
common:
  harness: ztest
  tags: [ui, zbus]
  platform_allow: [native_sim/native/64]
  timeout: 120
tests:
  zlrs.ui.state: {}
```
