## CMakeLists.txt
```
# SPDX-License-Identifier: Apache-2.0

cmake_minimum_required(VERSION 3.20.0)
find_package(Zephyr REQUIRED HINTS $ENV{ZEPHYR_BASE})
project(crypto)

get_filename_component(zlrs_root "${CMAKE_CURRENT_SOURCE_DIR}/../../.." ABSOLUTE)
target_sources(app PRIVATE src/main.c src/test_crypto.c
  "${zlrs_root}/app/src/platform/crypto.c")
target_include_directories(app PRIVATE "${zlrs_root}/app/src")

# Match the production placement of the two implementation files being measured.
zephyr_code_relocate(FILES
  "${zlrs_root}/app/src/platform/crypto.c"
  "${zlrs_root}/drivers/crypto/rp2350_sha256.c"
  LOCATION RAM_TEXT)
```

## Kconfig
```
# SPDX-License-Identifier: Apache-2.0

source "Kconfig.zephyr"

# The production adapter uses the application's standard logging setting.
module = APP
module-str = app
source "subsys/logging/Kconfig.template.log_config"
```

## prj.conf
```kconfig
# SPDX-License-Identifier: Apache-2.0

CONFIG_ZTEST=y
CONFIG_TEST_HW_STACK_PROTECTION=n
CONFIG_TEST_LOGGING_DEFAULTS=n
CONFIG_ZTEST_STACK_SIZE=3072
CONFIG_ZTEST_NO_YIELD=n
CONFIG_MAIN_STACK_SIZE=4096
CONFIG_BOOT_BANNER=n
CONFIG_HEAP_MEM_POOL_SIZE=4096
CONFIG_PM_DEVICE=y
CONFIG_ASSERT=y
CONFIG_SPEED_OPTIMIZATIONS=y
# RP2350 USB DPRAM faults on the toolchain memcpy halfword stores.
CONFIG_MINIMAL_LIBC=y
CONFIG_MINIMAL_LIBC_OPTIMIZE_STRING_FOR_SIZE=y
CONFIG_MINIMAL_LIBC_LL_PRINTF=y
CONFIG_SYS_CLOCK_TICKS_PER_SEC=1000
CONFIG_CODE_DATA_RELOCATION=y
CONFIG_CRYPTO=y
CONFIG_LOG=y
CONFIG_LOG_MODE_DEFERRED=y
CONFIG_LOG_PROCESS_THREAD=n
CONFIG_LOG_BACKEND_UART=y
CONFIG_LOG_PRINTK=n
CONFIG_CONSOLE=y
CONFIG_UART_CONSOLE=y
CONFIG_REBOOT=y
CONFIG_WATCHDOG=y

# caps.h requires the same storage capability as the application. No test accesses NVS.
CONFIG_FLASH=y
CONFIG_FLASH_MAP=y
CONFIG_NVS=y
CONFIG_IMG_MANAGER=y
CONFIG_STREAM_FLASH=y

CONFIG_ZLRS_USB=y
CONFIG_ZLRS_USB_PRODUCT="ZLRS CRYPTO TEST"
CONFIG_HWINFO=y
CONFIG_CDC_ACM_SERIAL_INITIALIZE_AT_BOOT=n
CONFIG_USBD_CDC_ACM_BUF_POOL=y
CONFIG_USBD_CDC_ACM_LOG_LEVEL_OFF=y
CONFIG_UDC_RPI_PICO_STACK_SIZE=2048
CONFIG_USBD_THREAD_STACK_SIZE=2048
```

## src/main.c
```c
/* SPDX-License-Identifier: Apache-2.0 */

#include <zephyr/device.h>
#include <zephyr/drivers/uart.h>
#include <zephyr/drivers/watchdog.h>
#include <zephyr/init.h>
#include <zephyr/kernel.h>
#include <zephyr/sys/reboot.h>
#include <zephyr/ztest.h>

static const struct device *const watchdog = DEVICE_DT_GET(DT_ALIAS(watchdog0));
static int watchdog_channel;

static void feed_watchdog(struct k_timer *timer)
{
	ARG_UNUSED(timer);
	(void)wdt_feed(watchdog, watchdog_channel);
}

K_TIMER_DEFINE(watchdog_timer, feed_watchdog, NULL);

static int arm_watchdog(void)
{
	const struct wdt_timeout_cfg timeout = {
		.window.max = 8000U,
		.flags = WDT_FLAG_RESET_SOC,
	};

	/* Arm before console/USB initialization so an early fault also causes rollback. */
	watchdog_channel = wdt_install_timeout(watchdog, &timeout);
	if (watchdog_channel < 0) {
		return watchdog_channel;
	}
	return wdt_setup(watchdog, 0U);
}

SYS_INIT(arm_watchdog, PRE_KERNEL_1, 51);

static void restore_firmware(struct k_work *work)
{
	ARG_UNUSED(work);
	/* Leave this image unconfirmed: MCUboot restores the previously confirmed firmware. */
	sys_reboot(SYS_REBOOT_COLD);
}

K_WORK_DELAYABLE_DEFINE(restore_work, restore_firmware);

void test_main(void)
{
	const struct device *const console = DEVICE_DT_GET(DT_CHOSEN(zephyr_console));
	uint32_t dtr = 0U;

	k_timer_start(&watchdog_timer, K_SECONDS(1), K_SECONDS(1));
	const int64_t deadline = k_uptime_get() + 45000;

	/* Capture every result after the host opens this test image's console CDC. */
	while (uart_line_ctrl_get(console, UART_LINE_CTRL_DTR, &dtr) != 0 || dtr == 0U) {
		if (k_uptime_get() >= deadline) {
			sys_reboot(SYS_REBOOT_COLD);
		}
		k_msleep(20);
	}
	k_msleep(100);
	ztest_run_all(NULL, false, 1, 1);
	ztest_verify_all_test_suites_ran();
	printk("ZLRS crypto tests complete; rebooting for MCUboot rollback in 3 s\n");
	k_work_schedule(&restore_work, K_SECONDS(3));
}
```

## src/test_crypto.c
```c
/* SPDX-License-Identifier: Apache-2.0 */

#include <zephyr/crypto/crypto.h>
#include <zephyr/device.h>
#include <zephyr/kernel.h>
#include <zephyr/sys/util.h>
#include <zephyr/ztest.h>

#include <errno.h>
#include <stdalign.h>
#include <stdint.h>
#include <string.h>

#include "zlrs/proto/crypto.h"
#include "vectors.h"

#define SHA256_LEN 32U
#define HASH_FLAGS (CAP_SEPARATE_IO_BUFS | CAP_SYNC_OPS)

static const struct device *const hash_dev = DEVICE_DT_GET(DT_NODELABEL(sha256));
static struct hash_ctx session;
static bool session_open;
static alignas(uint32_t) uint8_t data[511];
static alignas(uint32_t) uint8_t key[132];

static void before(void *fixture)
{
	ARG_UNUSED(fixture);
	zassert_true(device_is_ready(hash_dev), "SHA-256 driver unavailable");
	for (size_t i = 0U; i < sizeof(data); i++) {
		data[i] = (uint8_t)i;
	}
	for (size_t i = 0U; i < sizeof(key); i++) {
		key[i] = (uint8_t)i;
	}
	session = (struct hash_ctx){.flags = HASH_FLAGS};
}

static void after(void *fixture)
{
	ARG_UNUSED(fixture);
	if (session_open) {
		const int rc = hash_free_session(hash_dev, &session);

		session_open = false;
		zassert_ok(rc, "release hash session");
	}
}

static void begin(void)
{
	zassert_ok(hash_begin_session(hash_dev, &session, CRYPTO_HASH_ALGO_SHA256));
	session_open = true;
}

static void check_hex(const uint8_t *out, size_t len, const char *want)
{
	uint8_t expected[42];

	zassert_equal(hex2bin(want, len * 2U, expected, sizeof(expected)), len);
	zassert_mem_equal(out, expected, len);
}

ZTEST(crypto, test_sha_multipart_and_session_reuse)
{
	uint8_t out[SHA256_LEN];
	struct hash_pkt pkt = {.out_buf = out};
	unsigned int count = 0U;

	begin();
	for (size_t v = 0U; v < ARRAY_SIZE(sha_vectors); v++) {
		const size_t len = sha_vectors[v].len;
		const uint8_t *input = len == 3U ? (const uint8_t *)"abc" : data;
		const size_t chunks[] = {1U, 3U, 64U};

		/* One-shot and multiple chunks reuse the same session for fresh digests. */
		pkt.in_buf = input;
		pkt.in_len = len;
		zassert_ok(hash_compute(&session, &pkt));
		check_hex(out, sizeof(out), sha_vectors[v].want);
		count++;
		for (size_t c = 0U; c < ARRAY_SIZE(chunks); c++) {
			for (size_t offset = 0U; offset < len; offset += chunks[c]) {
				pkt.in_buf = input + offset;
				pkt.in_len = MIN(chunks[c], len - offset);
				zassert_ok(hash_update(&session, &pkt));
			}
			pkt.in_buf = NULL;
			pkt.in_len = 0U;
			zassert_ok(hash_compute(&session, &pkt));
			check_hex(out, sizeof(out), sha_vectors[v].want);
			count++;
		}
	}
	printk("SHA-256: %u one-shot/multipart/reused-session vectors passed\n", count);
}

ZTEST(crypto, test_session_errors_and_abandon)
{
	struct hash_ctx other = {.flags = HASH_FLAGS};
	struct hash_ctx unsupported = {.flags = CAP_SEPARATE_IO_BUFS | CAP_ASYNC_OPS};
	uint8_t out[SHA256_LEN];
	struct hash_pkt pkt = {.in_buf = data, .in_len = 3U, .out_buf = out};

	zassert_equal(hash_begin_session(hash_dev, &other, CRYPTO_HASH_ALGO_SHA512), -ENOTSUP);
	zassert_equal(hash_begin_session(hash_dev, &unsupported, CRYPTO_HASH_ALGO_SHA256),
		      -ENOTSUP);
	begin();
	zassert_equal(hash_begin_session(hash_dev, &other, CRYPTO_HASH_ALGO_SHA256), -EBUSY);
	zassert_equal(hash_free_session(hash_dev, &other), -EINVAL);
	pkt.in_buf = NULL;
	zassert_equal(hash_update(&session, &pkt), -EINVAL);
	pkt.in_buf = data;
	pkt.out_buf = NULL;
	zassert_equal(hash_compute(&session, &pkt), -EINVAL);
	pkt.out_buf = out;
	pkt.in_len = SIZE_MAX;
	zassert_equal(hash_update(&session, &pkt), -EOVERFLOW);
	pkt.in_len = 3U;
	zassert_ok(hash_update(&session, &pkt));
	zassert_ok(hash_free_session(hash_dev, &session));
	session_open = false;
	zassert_equal(hash_free_session(hash_dev, &session), -EINVAL);
	begin();
	pkt.in_buf = (const uint8_t *)"abc";
	zassert_ok(hash_compute(&session, &pkt));
	check_hex(out, sizeof(out), sha_vectors[1].want);
}

ZTEST(crypto, test_authentication_tags)
{
	uint8_t tag[ZLRS_TAG_LEN];
	alignas(uint32_t) uint8_t shifted[510];

	for (size_t i = 0U; i < ARRAY_SIZE(hmac_vectors); i++) {
		/* Unaligned key and message exercise the production backend's byte path. */
		for (size_t n = 0U; n < 131U; n++) {
			key[n + 1U] = (uint8_t)n;
		}
		for (size_t n = 0U; n < 255U; n++) {
			data[n + 1U] = (uint8_t)n;
		}
		zlrs_tag(key + 1U, hmac_vectors[i].key_len, data + 1U, hmac_vectors[i].len,
			 tag);
		check_hex(tag, sizeof(tag), hmac_vectors[i].want);
	}
	for (size_t i = 0U; i < 32U; i++) {
		key[i] = (uint8_t)i;
	}
	for (size_t i = 0U; i < 507U; i++) {
		data[i] = (uint8_t)i;
	}
	for (size_t offset = 0U; offset < 4U; offset++) {
		memcpy(shifted + offset, data, 507U);
		zlrs_tag(key, 32U, shifted + offset, 507U, tag);
		check_hex(tag, sizeof(tag), "5521f6da");
	}
	printk("HMAC tags: %u vectors passed, including 507 B at offsets 0..3\n",
	       (unsigned int)ARRAY_SIZE(hmac_vectors) + 4U);
}

ZTEST(crypto, test_key_derivation)
{
	uint8_t ctx[16];
	uint8_t out[42];
	char phrase[101];
	uint8_t ikm[22];
	const uint8_t info[] = {0xf0, 0xf1, 0xf2, 0xf3, 0xf4, 0xf5, 0xf6, 0xf7, 0xf8, 0xf9};

	memset(ikm, 0x0b, sizeof(ikm));
	zlrs_kdf(ikm, sizeof(ikm), "", info, sizeof(info), out, SHA256_LEN);
	check_hex(out, SHA256_LEN,
		  "abbafb13f5c1bc489d4203135817956dd521b39e3bd61d1cc85cef884d1f8e2e");
	for (size_t i = 0U; i < sizeof(ctx); i++) {
		ctx[i] = (uint8_t)(0x40U + i);
	}
	zlrs_kdf(key, 32U, "zlrs/pair", ctx, sizeof(ctx), out, sizeof(out));
	check_hex(out, sizeof(out),
		  "1c6418d29272536de8c6d1492587bc52fb374109a5c313e02badd158066e58b7d"
		  "8cd11057bdddc8ec2e4");
	zlrs_pbkdf2_sha256("password", (const uint8_t *)"salt", 4U, 1U, out);
	check_hex(out, SHA256_LEN,
		  "120fb6cffcf8b32c43e7225256c4f837a86548c92ccc35480805987cb70be17b");
	zlrs_pbkdf2_sha256("password", (const uint8_t *)"salt", 4U, 2U, out);
	check_hex(out, SHA256_LEN,
		  "ae4d0c95af6b46d32d0adff928f06dd02a303f8ef3c251dfd6e2d85a95474c43");
	memset(phrase, 'P', sizeof(phrase) - 1U);
	phrase[sizeof(phrase) - 1U] = '\0';
	zlrs_pbkdf2_sha256(phrase, key, 32U, 5U, out);
	check_hex(out, SHA256_LEN,
		  "ba71e3c0299a60aa5620773114321003bf0a2044b09408313015054a177f510e");
}

ZTEST(crypto, test_production_passphrase)
{
	uint8_t out[SHA256_LEN];
	const int64_t started = k_uptime_get();

	zlrs_root_key_from_phrase("ZLRS hardware KDF timing", out);
	printk("PBKDF2 %u rounds: %lld ms\n", ZLRS_KDF_V1_ITERATIONS,
	       (long long)(k_uptime_get() - started));
	check_hex(out, sizeof(out),
		  "c435dcd88e863c3e9d0c00458a92cffcda5ad2bb412d4cc5a55066f3b863bb0e");
}

ZTEST(crypto, test_tag_timing)
{
	const uint16_t lengths[] = {251U, 507U};
	alignas(uint32_t) uint8_t shifted[510];
	uint8_t tag[ZLRS_TAG_LEN];

	for (size_t n = 0U; n < ARRAY_SIZE(lengths); n++) {
		for (size_t offset = 0U; offset < 2U; offset++) {
			uint32_t elapsed = 0U;
			uint32_t worst = 0U;

			memcpy(shifted + offset, data, lengths[n]);
			for (unsigned int i = 0U; i < 64U; i++) {
				const uint32_t start = k_cycle_get_32();

				zlrs_tag(key, 32U, shifted + offset, lengths[n], tag);
				const uint32_t cycles = k_cycle_get_32() - start;

				elapsed += cycles;
				worst = MAX(worst, cycles);
			}
			check_hex(tag, sizeof(tag), lengths[n] == 251U ? "9f3c65f8" : "5521f6da");
			printk("crypto %u-byte tag offset=%u: average=%u us max=%u us (64 calls)\n",
			       lengths[n], (unsigned int)offset,
			       k_cyc_to_us_ceil32(elapsed) / 64U, k_cyc_to_us_ceil32(worst));
		}
	}
}

ZTEST_SUITE(crypto, NULL, NULL, before, after, NULL);
```

## src/vectors.h
```c
/* SPDX-License-Identifier: Apache-2.0 */

#pragma once

/* Independent expected values generated with Python hashlib/hmac. */
static const struct {
	uint16_t len;
	const char *want;
} sha_vectors[] = {
	{0U, "e3b0c44298fc1c149afbf4c8996fb92427ae41e4649b934ca495991b7852b855"},
	{3U, "ba7816bf8f01cfea414140de5dae2223b00361a396177a9cb410ff61f20015ad"},
	{55U, "463eb28e72f82e0a96c0a4cc53690c571281131f672aa229e0d45ae59b598b59"},
	{56U, "da2ae4d6b36748f2a318f23e7ab1dfdf45acdc9d049bd80e59de82a60895f562"},
	{63U, "29af2686fd53374a36b0846694cc342177e428d1647515f078784d69cdb9e488"},
	{64U, "fdeab9acf3710362bd2658cdc9a29e8f9c757fcf9811603a8c447cd1d9151108"},
	{65U, "4bfd2c8b6f1eec7a2afeb48b934ee4b2694182027e6d0fc075074f2fabb31781"},
	{255U, "3f8591112c6bbe5c963965954e293108b7208ed2af893e500d859368c654eabe"},
};

static const struct {
	uint16_t key_len;
	uint16_t len;
	const char *want;
} hmac_vectors[] = {
	{32U, 0U, "d38b42096d80f45f826b44a9d5607de72496a415d3f4a1a8c88e3bb9da8dc1cb"},
	{32U, 1U, "e711546e3faad4c7c4aa756bc26cad6abea8241984a0f6b0839c70ca61c4ef88"},
	{32U, 55U, "b478e4cbd63871759702a8a4c9828359869bc9e20d3df429ecd08f5a5d3d9340"},
	{32U, 56U, "e5d1f65e9e9359d05c577b6890044f08c9a1f7969b683f1237ef07db70e5f862"},
	{32U, 63U, "d37a8dadb82b15310342ceabf0de8cb8991ee9bd55dd3e4813e952081cb24bf1"},
	{32U, 64U, "173206781c3b828a0dc2a716fe0ddb5e6e56ec171170952ff6b3f4de44fa18d7"},
	{32U, 65U, "22084084cc171f63dfdd6ca4bcb0c29be8d4ff1cc6b1d0d21e10e2a2a0bfce9c"},
	{32U, 251U, "9f3c65f884ad74347badf93743fbbb6acfe8d1ce807e8217a5fc2d6838d7fcf9"},
	{131U, 200U, "c4b86c4234bc84b889b659e1d14fb2f63a633db5f37618306da3b036564d9ee9"},
};
```
