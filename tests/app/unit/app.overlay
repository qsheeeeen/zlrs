/* SPDX-License-Identifier: Apache-2.0 */
#include <zephyr/dt-bindings/zlrs/region.h>
/ {
	zlrs_rf: radio-config {
		compatible = "zlrs,radio";
		regions = <ZLRS_REGION_FCC915 ZLRS_REGION_EU868
				     ZLRS_REGION_CN470 ZLRS_REGION_CN433>;
		default-region = <ZLRS_REGION_FCC915>;
		ism2400-min-tx-power-dbm = <(-17)>;
		ism2400-max-tx-power-dbm = <12>;
		subg-min-tx-power-dbm = <(-10)>;
		subg-max-tx-power-dbm = <22>;
	};
};
