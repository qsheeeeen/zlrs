/* SPDX-License-Identifier: Apache-2.0 */
/ {
	fstab {
		compatible = "zephyr,fstab";
		zlrs_log_fs: log {
			compatible = "zephyr,fstab,littlefs";
			mount-point = "/lfs";
			partition = <&storage_partition>;
			read-size = <16>;
			prog-size = <16>;
			cache-size = <64>;
			lookahead-size = <32>;
			block-cycles = <512>;
			automount;
		};
	};
};
