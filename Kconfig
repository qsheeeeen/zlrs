## boards/shields/waveshare_core2021/Kconfig.shield
```kconfig
# Copyright (c) 2026 zlrs contributors
# SPDX-License-Identifier: Apache-2.0

config SHIELD_WAVESHARE_CORE2021
	def_bool $(shields_list_contains,waveshare_core2021)
```

## boards/waveshare/rp2350_zero/Kconfig.rp2350_zero
```kconfig
# Copyright (c) 2026 zlrs contributors
# SPDX-License-Identifier: Apache-2.0

config BOARD_RP2350_ZERO
	select SOC_RP2350A_M33
```

## boards/waveshare/rp2350_zero/board.yml
```yaml
# Copyright (c) 2026 zlrs contributors
# SPDX-License-Identifier: Apache-2.0

board:
  name: rp2350_zero
  full_name: Waveshare RP2350-Zero
  vendor: waveshare
  socs:
    - name: rp2350a
```

## boards/zlrs/rp2350_zero_core2021/rp2350_zero_core2021_rp2350a_m33_defconfig
```kconfig
# Copyright (c) 2026 zlrs contributors
# SPDX-License-Identifier: Apache-2.0
#
# 板级公共配置在 Kconfig.defconfig 里，这里只放"不带变体"这一档的默认值。
# 不带变体 = HF（见 rp2350_zero_core2021_rp2350a_m33.dts）。

CONFIG_ZLRS_APP_REGION=0
```

## core/crsf/Kconfig
```kconfig
# Copyright (c) 2026 zlrs contributors
# SPDX-License-Identifier: Apache-2.0

config ZLRS_CRSF
	bool "CRSF framing, routing and device protocol"
	help
	  CRSF channel packing, frame validation, link statistics, device discovery,
	  parameter menus, commands, baud negotiation and CRSF Shot timing reports.
	  Other telemetry and MSP frames are routed unchanged by the application.
	  Pure C, see tests/host.

module = ZLRS_CRSF
module-str = zlrs_crsf
source "subsys/logging/Kconfig.template.log_config"
```

## core/led/Kconfig
```kconfig
# Copyright (c) 2026 zlrs contributors
# SPDX-License-Identifier: Apache-2.0

config ZLRS_LED
	bool "Status LED patterns (state -> colour and cadence)"
	select ZLRS_LINK
	help
	  Maps link state and alerts onto one pixel's colour and cadence (table: doc/11-ux.md).
	  Pure C, see tests/host; the thread that renders the application's system state through
	  this engine, and the strip it writes, live in the application (app/src/ui/led.c).

module = ZLRS_LED
module-str = zlrs_led
source "subsys/logging/Kconfig.template.log_config"
```

## core/link/Kconfig
```kconfig
# Copyright (c) 2026 zlrs contributors
# SPDX-License-Identifier: Apache-2.0

config ZLRS_LINK
	bool "Link state machine, pairing and sessions"
	select ZLRS_PROTO
	select ZLRS_CRSF
	help
	  Link state machine, pairing, session handling and the reliable CRSF frame service,
	  and the radio abstraction the
	  application implements on top of USP/RAC. Pure C, see tests/host.

module = ZLRS_LINK
module-str = zlrs_link
source "subsys/logging/Kconfig.template.log_config"
```

## core/mgmt/Kconfig
```kconfig
# Copyright (c) 2026 zlrs contributors
# SPDX-License-Identifier: Apache-2.0

config ZLRS_MGMT
	bool "Management protocol (frame and status codecs)"
	select ZLRS_PROTO
	help
	  Pure C management frame and status codecs, tested on the host.
```

## core/proto/Kconfig
```kconfig
# Copyright (c) 2026 zlrs contributors
# SPDX-License-Identifier: Apache-2.0

config ZLRS_PROTO
	bool "Protocol core (framing, FHSS sequence, reassembly, CRC)"
	help
	  Pure C framing and protocol crypto, without a Zephyr dependency. HMAC, HKDF
	  and PBKDF2 use the SHA-256 operation supplied by the application. Host tests
	  can supply a software SHA-256 implementation.

module = ZLRS_PROTO
module-str = zlrs_proto
source "subsys/logging/Kconfig.template.log_config"
```

## drivers/crypto/Kconfig
```kconfig
# Copyright (c) 2026 zlrs contributors
# SPDX-License-Identifier: Apache-2.0

config ZLRS_RP2350_SHA256
	bool "ZLRS RP2350 SHA-256 Crypto driver"
	default y
	depends on DT_HAS_ZLRS_RP2350_SHA256_ENABLED && CRYPTO && SOC_RP2350A_M33
	select PICOSDK_USE_SHA256
	help
	  Hardware SHA-256 through the Zephyr Crypto API, with one-shot and multipart
	  hashing. Pico SDK handles word-aligned input and partial words without joining
	  input buffers. One active session owns the accelerator and the ROM SHA lock.
```

## drivers/entropy/Kconfig
```kconfig
# Copyright (c) 2026 zlrs contributors
# SPDX-License-Identifier: Apache-2.0

menu "zlrs RP2350 TRNG"

config ZLRS_RP2350_TRNG
	bool "zlrs RP2350 TRNG entropy driver"
	default y
	# Only built into images with the entropy subsystem (the bootloader has no ENTROPY_GENERATOR)
	depends on DT_HAS_ZLRS_RP2350_TRNG_ENABLED && ENTROPY_GENERATOR
	select ENTROPY_HAS_DRIVER
	select RING_BUFFER
	select POLL
	help
	  Drives the TRNG registers directly per RP2350 datasheet 12.12: 6 EHR words per 192-bit
	  block. Its IRQ publishes validated blocks to a 48-byte pool. Delayed work
	  handles bounded timeouts and recovery without waiting on hardware.
	  Ordinary reads wait with a deadline; ISR-safe reads consume only ready bytes.
	  Zephyr's entropy_rpi_pico goes through pico-sdk get_rand_64(), which spins with interrupts
	  off and kills USB, so it is not used here. See doc/08-security.md#entropy-contract.

if ZLRS_RP2350_TRNG

module = ZLRS_TRNG
module-str = zlrs_trng
source "subsys/logging/Kconfig.template.log_config"

endif # ZLRS_RP2350_TRNG

endmenu
```

## drivers/trng/Kconfig
```kconfig
# Copyright (c) 2026 zlrs contributors
# SPDX-License-Identifier: Apache-2.0

menu "zlrs RP2350 TRNG"

config ZLRS_RP2350_TRNG
	bool "zlrs 的 RP2350 TRNG 熵源驱动"
	default y
	# 只在启用了熵子系统的镜像里编（bootloader 没有 ENTROPY_GENERATOR）
	depends on DT_HAS_ZLRS_RP2350_TRNG_ENABLED && ENTROPY_GENERATOR
	select ENTROPY_HAS_DRIVER
	help
	  按 RP2350 datasheet 12.12 直接操作 TRNG 寄存器：每块 192 bit 读满 6 个
	  EHR 字，取数走小池子、等待有界，不关中断、不拿自旋锁。Zephyr 自带的
	  entropy_rpi_pico 走 pico-sdk get_rand_64()，取数时关中断忙等，会让 USB
	  停摆——所以这台上不用它，见 doc/13-roadmap.md。

if ZLRS_RP2350_TRNG

module = ZLRS_TRNG
module-str = zlrs_trng
source "subsys/logging/Kconfig.template.log_config"

endif # ZLRS_RP2350_TRNG

endmenu
```

## dts/bindings/crypto/zlrs,rp2350-sha256.yaml
```yaml
# Copyright (c) 2026 zlrs contributors
# SPDX-License-Identifier: Apache-2.0

description: ZLRS RP2350 SHA-256 accelerator with multipart hashing

compatible: "zlrs,rp2350-sha256"

include: base.yaml

properties:
  reg:
    required: true
```

## dts/bindings/rng/zlrs,rp2350-trng.yaml
```yaml
# Copyright (c) 2026 zlrs contributors
# SPDX-License-Identifier: Apache-2.0

description: zlrs RP2350 TRNG entropy source (bounded waits, interrupts stay on)

compatible: "zlrs,rp2350-trng"

include: base.yaml

properties:
  reg:
    required: true
```

## dts/bindings/timer/zlrs,rp2350-slot-timer.yaml
```yaml
# Copyright (c) 2026 zlrs contributors
# SPDX-License-Identifier: Apache-2.0

description: Dedicated RP2350 hardware timer for radio slot boundaries
compatible: "zlrs,rp2350-slot-timer"
include: [base.yaml, reset-device.yaml]
properties:
  reg:
    required: true
  clocks:
    required: true
  interrupts:
    required: true
```

## dts/bindings/zlrs,crsf-port.yaml
```yaml
# Copyright (c) 2026 zlrs contributors
# SPDX-License-Identifier: Apache-2.0
description: ZLRS CRSF UART electrical configuration
compatible: "zlrs,crsf-port"
include: base.yaml
properties:
  release-timer:
    type: phandle
    required: true
    description: Dedicated microsecond counter for UART line release
  tx-gpios:
    type: phandle-array
    required: true
    description: UART TX pad released to high impedance in handset mode
  handset-baud:
    type: int
    required: true
  fc-baud:
    type: int
    required: true
```
